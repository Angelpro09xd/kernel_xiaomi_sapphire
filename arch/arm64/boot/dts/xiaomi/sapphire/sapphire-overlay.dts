/dts-v1/;
/plugin/;

#include <dt-bindings/interrupt-controller/arm-gic.h>
#include "khaje-idp-nopmi.dtsi"
#include "sapphire.dtsi"

/ {
	model = "Qualcomm Technologies, Inc. Khaje IDP sapphire";
	compatible = "qcom,khaje-idp", "qcom,khaje", "qcom,idp";
	qcom,msm-id = <0x24a 0x10000>, <0x206 0x10000>;
	qcom,board-id = <0x20022 0x0>;
	qcom,pmic-id = <0x2d 0x2e 0x0 0x0>;
};
