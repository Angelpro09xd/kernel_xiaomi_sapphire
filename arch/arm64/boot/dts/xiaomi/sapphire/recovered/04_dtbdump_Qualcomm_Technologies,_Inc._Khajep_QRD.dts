/dts-v1/;

/ {
	model = "Qualcomm Technologies, Inc. Khajep QRD";
	compatible = "qcom,khajep-qrd", "qcom,khajep", "qcom,qrd";
	qcom,msm-id = <0x231 0x10000>;
	qcom,board-id = <0x1000b 0x0>;
	qcom,pmic-id = <0x2d 0x2e 0x0 0x0>;

	fragment@0 {
		target = <0xffffffff>;

		__overlay__ {

			pm6125-tz {

				cooling-maps {

					trip0_cpu0 {
						trip = <0xffffffff>;
						cooling-device = <0xffffffff 0x7 0x7>;
					};

					trip0_cpu4 {
						trip = <0xffffffff>;
						cooling-device = <0xffffffff 0x6 0xffffffff>;
					};

					trip1_cpu1 {
						trip = <0xffffffff>;
						cooling-device = <0xffffffff 0x1 0x1>;
					};

					trip1_cpu2 {
						trip = <0xffffffff>;
						cooling-device = <0xffffffff 0x1 0x1>;
					};

					trip1_cpu3 {
						trip = <0xffffffff>;
						cooling-device = <0xffffffff 0x1 0x1>;
					};

					trip1_cpu4 {
						trip = <0xffffffff>;
						cooling-device = <0xffffffff 0x1 0x1>;
					};

					trip1_cpu5 {
						trip = <0xffffffff>;
						cooling-device = <0xffffffff 0x1 0x1>;
					};

					trip1_cpu6 {
						trip = <0xffffffff>;
						cooling-device = <0xffffffff 0x1 0x1>;
					};

					trip1_cpu7 {
						trip = <0xffffffff>;
						cooling-device = <0xffffffff 0x1 0x1>;
					};
				};
			};
		};
	};

	fragment@1 {
		target = <0xffffffff>;

		__overlay__ {

			key_vol_up {

				key_vol_up_default {
					pins = "gpio5";
					function = "normal";
					input-enable;
					bias-pull-up;
					power-source = <0x0>;
					phandle = <0x1>;
				};
			};

			eldo9_pin {

				gpio@c000 {
					pins = "gpio1";
					function = "normal";
					qcom,drive-strength = <0x2>;
					power-source = <0x0>;
					bias-disable;
					output-high;
					phandle = <0x2>;
				};
			};
		};
	};

	fragment@2 {
		target = <0xffffffff>;

		__overlay__ {

			gpio_keys {
				compatible = "gpio-keys";
				label = "gpio-keys";
				pinctrl-names = "default";
				pinctrl-0 = <0x1>;

				vol_up {
					label = "volume_up";
					gpios = <0xffffffff 0x5 0x1>;
					linux,input-type = <0x1>;
					linux,code = <0x73>;
					linux,can-disable;
					debounce-interval = <0xf>;
					gpio-key,wakeup;
				};
			};

			vdda_usb_ss_dp_core {
				compatible = "regulator-fixed";
				regulator-name = "vdd_supply";
				regulator-min-microvolt = <0xd6d80>;
				regulator-max-microvolt = <0xd6d80>;
				enable-active-high;
				gpio = <0xffffffff 0x1 0x0>;
				pinctrl-names = "default";
				pinctrl-0 = <0x2>;
				phandle = <0x3>;
			};
		};
	};

	fragment@3 {
		target = <0xffffffff>;

		__overlay__ {
			vdd-supply = <0x3>;
		};
	};

	fragment@4 {
		target = <0xffffffff>;

		__overlay__ {

			awinic@64 {
				compatible = "awinic,aw2016_led";
				reg = <0x64>;

				awinic,red {
					awinic,name = "red";
					awinic,id = <0x0>;
					awinic,imax = <0x2>;
					awinic,led-current = <0x3>;
					awinic,max-brightness = <0xff>;
					awinic,rise-time-ms = <0x6>;
					awinic,hold-time-ms = <0x0>;
					awinic,fall-time-ms = <0x6>;
					awinic,off-time-ms = <0x4>;
				};

				awinic,green {
					awinic,name = "green";
					awinic,id = <0x1>;
					awinic,imax = <0x2>;
					awinic,led-current = <0x3>;
					awinic,max-brightness = <0xff>;
					awinic,rise-time-ms = <0x6>;
					awinic,hold-time-ms = <0x0>;
					awinic,fall-time-ms = <0x6>;
					awinic,off-time-ms = <0x4>;
				};

				awinic,blue {
					awinic,name = "blue";
					awinic,id = <0x2>;
					awinic,imax = <0x2>;
					awinic,led-current = <0x3>;
					awinic,max-brightness = <0xff>;
					awinic,rise-time-ms = <0x6>;
					awinic,hold-time-ms = <0x0>;
					awinic,fall-time-ms = <0x6>;
					awinic,off-time-ms = <0x4>;
				};
			};
		};
	};

	fragment@5 {
		target = <0xffffffff>;

		__overlay__ {
			vdd-supply = <0xffffffff>;
			qcom,vdd-voltage-level = <0x2d2a80 0x2d2a80>;
			qcom,vdd-current-level = <0x0 0x8b290>;
			vdd-io-supply = <0xffffffff>;
			qcom,vdd-io-always-on;
			qcom,vdd-io-lpm-sup;
			qcom,vdd-io-voltage-level = <0x1b7740 0x1b7740>;
			qcom,vdd-io-current-level = <0x0 0x4f588>;
			pinctrl-names = "default", "sleep";
			pinctrl-0 = <0xffffffff>;
			pinctrl-1 = <0xffffffff>;
			status = "ok";
		};
	};

	fragment@6 {
		target = <0xffffffff>;

		__overlay__ {
			vdd-supply = <0xffffffff>;
			qcom,vdd-voltage-level = <0x2d2a80 0x2d2a80>;
			qcom,vdd-current-level = <0x0 0xc3500>;
			vdd-io-supply = <0xffffffff>;
			qcom,vdd-io-voltage-level = <0x1b7740 0x2d2a80>;
			qcom,vdd-io-current-level = <0x0 0x55f0>;
			vdd-io-bias-supply = <0xffffffff>;
			qcom,vdd-io-bias-voltage-level = <0x132a40 0x132a40>;
			qcom,vdd-io-bias-current-level = <0x0 0x1770>;
			pinctrl-names = "default", "sleep";
			pinctrl-0 = <0xffffffff>;
			pinctrl-1 = <0xffffffff>;
			cd-gpios = <0xffffffff 0x58 0x1>;
			status = "ok";
		};
	};

	fragment@7 {
		target = <0xffffffff>;

		__overlay__ {
			compatible = "qcom,ufs-phy-qmp-v4-khaje";
			vdda-phy-supply = <0xffffffff>;
			vdda-pll-supply = <0xffffffff>;
			vdda-phy-max-microamp = <0x14ec4>;
			vdda-pll-max-microamp = <0x477c>;
			status = "ok";
		};
	};

	fragment@8 {
		target = <0xffffffff>;

		__overlay__ {
			vdd-hba-supply = <0xffffffff>;
			vdd-hba-fixed-regulator;
			vcc-supply = <0xffffffff>;
			vcc-max-microamp = <0xc3500>;
			vccq2-supply = <0xffffffff>;
			vccq2-max-microamp = <0xc3500>;
			qcom,vddp-ref-clk-supply = <0xffffffff>;
			qcom,vddp-ref-clk-max-microamp = <0x64>;
			reset-gpios = <0xffffffff 0x71 0x1>;
			resets = <0xffffffff 0x4>;
			reset-names = "rst";
			status = "ok";
		};
	};

	fragment@9 {
		target = <0xffffffff>;

		__overlay__ {
			status = "ok";
		};
	};

	fragment@10 {
		target = <0xffffffff>;

		__overlay__ {
			status = "okay";
			qcom,i2c-touch-active = "synaptics,tcm-i2c";

			synaptics_tcm@20 {
				compatible = "synaptics,tcm-i2c";
				reg = <0x20>;
				interrupt-parent = <0xffffffff>;
				interrupts = <0x50 0x2008>;
				pinctrl-names = "pmx_ts_active", "pmx_ts_suspend", "pmx_ts_release";
				pinctrl-0 = <0xffffffff 0xffffffff>;
				pinctrl-1 = <0xffffffff 0xffffffff>;
				pinctrl-2 = <0xffffffff>;
				synaptics,irq-gpio = <0xffffffff 0x50 0x2008>;
				synaptics,irq-on-state = <0x0>;
				synaptics,reset-gpio = <0xffffffff 0x56 0x0>;
				synaptics,reset-on-state = <0x0>;
				synaptics,reset-active-ms = <0x14>;
				synaptics,reset-delay-ms = <0xc8>;
				synaptics,power-delay-ms = <0xc8>;
				synaptics,ubl-i2c-addr = <0x20>;
				synaptics,extend_report;
				synaptics,firmware-name = "synaptics_firmware_k.img";
			};
		};
	};

	fragment@11 {
		target = <0xffffffff>;

		__overlay__ {

			quiet-therm {
				polling-delay-passive = <0x7d0>;

				trips {

					batt-trip0 {
						temperature = <0xa028>;
						hysteresis = <0x7d0>;
						type = "passive";
						phandle = <0x1f>;
					};

					modem-trip0 {
						temperature = <0xa410>;
						hysteresis = <0x7d0>;
						type = "passive";
						phandle = <0x8>;
					};

					batt-trip1 {
						temperature = <0xa7f8>;
						hysteresis = <0x7d0>;
						type = "passive";
						phandle = <0x20>;
					};

					batt-trip2 {
						temperature = <0xafc8>;
						hysteresis = <0x7d0>;
						type = "passive";
						phandle = <0x21>;
					};

					gold-trip {
						temperature = <0xb798>;
						hysteresis = <0x0>;
						type = "passive";
						phandle = <0x4>;
					};

					batt-trip3 {
						temperature = <0xb798>;
						hysteresis = <0x7d0>;
						type = "passive";
						phandle = <0x22>;
					};

					batt-trip4 {
						temperature = <0xbb80>;
						hysteresis = <0x3e8>;
						type = "passive";
						phandle = <0x23>;
					};

					gpu-trip {
						temperature = <0xbb80>;
						hysteresis = <0xfa0>;
						type = "passive";
						phandle = <0x6>;
					};

					silver-trip {
						temperature = <0xc350>;
						hysteresis = <0x0>;
						type = "passive";
						phandle = <0x5>;
					};

					hvx-trip {
						temperature = <0xcb20>;
						hysteresis = <0xfa0>;
						type = "passive";
						phandle = <0x7>;
					};

					modem-trip1 {
						temperature = <0xea60>;
						hysteresis = <0xfa0>;
						type = "passive";
						phandle = <0x9>;
					};
				};

				cooling-maps {

					gold_cdev {
						trip = <0x4>;
						cooling-device = <0xffffffff 0x0 0x4>;
					};

					silver_cdev {
						trip = <0x5>;
						cooling-device = <0xffffffff 0x0 0x2>;
					};

					gpu_cdev {
						trip = <0x6>;
						cooling-device = <0xffffffff 0x0 0x3>;
					};

					hvx_cdev {
						trip = <0x7>;
						cooling-device = <0xffffffff 0x4 0x4>;
					};

					mdm_cdev0 {
						trip = <0x8>;
						cooling-device = <0xffffffff 0x1 0x1>;
					};

					mdm_cdev1 {
						trip = <0x9>;
						cooling-device = <0xffffffff 0x3 0x3>;
					};
				};
			};

			pa-therm0 {

				trips {

					pa-therm0-trip0 {
						temperature = <0xcb20>;
						hysteresis = <0x7d0>;
						type = "passive";
						phandle = <0xa>;
					};

					pa-therm0-trip1 {
						temperature = <0xd2f0>;
						hysteresis = <0x7d0>;
						type = "passive";
						phandle = <0xb>;
					};

					pa-therm0-trip2 {
						temperature = <0xea60>;
						hysteresis = <0xfa0>;
						type = "passive";
						phandle = <0xc>;
					};
				};

				cooling-maps {

					modem_cdev0 {
						trip = <0xa>;
						cooling-device = <0xffffffff 0x1 0x1>;
					};

					modem_cdev1 {
						trip = <0xb>;
						cooling-device = <0xffffffff 0x2 0x2>;
					};

					modem_cdev2 {
						trip = <0xc>;
						cooling-device = <0xffffffff 0x3 0x3>;
					};
				};
			};
		};
	};

	fragment@12 {
		target = <0xffffffff>;

		__overlay__ {

			fpc_reset_int {
				phandle = <0x24>;

				reset_low {
					phandle = <0x25>;

					mux {
						pins = "gpio104";
						function = "gpio";
					};

					config {
						pins = "gpio104";
						drive-strength = <0x2>;
						bias-disable;
						output-low;
					};
				};

				reset_high {
					phandle = <0x26>;

					mux {
						pins = "gpio104";
						function = "gpio";
					};

					config {
						pins = "gpio104";
						drive-strength = <0x2>;
						bias-disable;
						output-high;
					};
				};

				int_low {
					phandle = <0x27>;

					mux {
						pins = "gpio97";
						function = "gpio";
					};

					config {
						pins = "gpio97";
						drive-strength = <0x2>;
						bias-pull-down;
						input-enable;
					};
				};
			};
		};
	};

	fragment@13 {
		target = <0xffffffff>;

		__overlay__ {
		};
	};

	fragment@14 {
		target = <0xffffffff>;

		__overlay__ {
			#address-cells = <0x2>;
			#size-cells = <0x0>;
			interrupt-controller;
			#interrupt-cells = <0x4>;

			qcom,pm7250b@2 {
				compatible = "qcom,spmi-pmic";
				reg = <0x2 0x0>;
				#address-cells = <0x1>;
				#size-cells = <0x0>;

				qcom,qpnp-smb5 {
					compatible = "qcom,pm7250b-smb5";
					depends-on-supply = <0xd>;
					#address-cells = <0x1>;
					#size-cells = <0x1>;
					#cooling-cells = <0x2>;
					qcom,thermal-mitigation = <0x7a1200 0x7270e0 0x6acfc0 0x632ea0 0x5b8d80 0x53ec60 0x4c4b40 0x44aa20 0x3d0900 0x3567e0 0x2dc6c0 0x2625a0 0x1e8480 0x16e360 0xf4240 0x7a120>;
					qcom,hvdcp2-max-icl-ua = <0x1e8480>;
					qcom,hvdcp2-12v-max-icl-ua = <0x16e360>;
					status = "ok";
					#io-channel-cells = <0x1>;
					io-channels = <0xd 0x8 0xd 0x7 0xd 0x9 0xd 0x6 0xd 0x4f 0xd 0x99 0xd 0x83 0xd 0x4d 0xe 0x4b 0xe 0x46 0xe 0x45 0xe 0x42 0xe 0x47 0xe 0x5d 0xe 0x4e 0xe 0x44 0xe 0x5b 0xe 0x48 0xe 0x2d 0xe 0x53 0xe 0x49 0xe 0x52 0xe 0x54 0xe 0x56>;
					io-channel-names = "usb_in_voltage", "usb_in_current", "chg_temp", "die_temp", "conn_temp", "sbux_res", "vph_voltage", "skin_temp", "resistance_id", "voltage_now", "temp", "capacity", "voltage_ocv", "voltage_avg", "debug_battery", "real_capacity", "cc_soc", "current_now", "voltage_max", "charge_full", "charge_counter", "cycle_count", "charge_full_design", "time_to_full_now";
					qcom,battery-data = <0xf>;
					qcom,sec-charger-config = <0x1>;
					qcom,auto-recharge-soc = <0x62>;
					qcom,step-charging-enable;
					qcom,sw-jeita-enable;
					qcom,charger-temp-max = <0x320>;
					qcom,smb-temp-max = <0x320>;
					qcom,suspend-input-on-debug-batt;
					qcom,fcc-stepping-enable;
					qcom,fcc-step-delay-ms = <0x64>;
					qcom,fcc-step-size-ua = <0x186a0>;
					qcom,smb-internal-pull-kohm = <0x0>;
					dpdm-supply = <0xffffffff>;
					phandle = <0x12>;

					qcom,chgr@1000 {
						reg = <0x1000>;
						interrupts = <0x2 0x10 0x0 0x1 0x2 0x10 0x1 0x1 0x2 0x10 0x2 0x1 0x2 0x10 0x3 0x1 0x2 0x10 0x4 0x1 0x2 0x10 0x5 0x1 0x2 0x10 0x6 0x1 0x2 0x10 0x7 0x1>;
						interrupt-names = "chgr-error", "chg-state-change", "step-chg-state-change", "step-chg-soc-update-fail", "step-chg-soc-update-req", "fg-fvcal-qualified", "vph-alarm", "vph-drop-prechg";
					};

					qcom,dcdc@1100 {
						reg = <0x1100>;
						interrupts = <0x2 0x11 0x0 0x1 0x2 0x11 0x1 0x1 0x2 0x11 0x2 0x1 0x2 0x11 0x3 0x3 0x2 0x11 0x4 0x3 0x2 0x11 0x5 0x3 0x2 0x11 0x6 0x1 0x2 0x11 0x7 0x3>;
						interrupt-names = "otg-fail", "otg-oc-disable-sw", "otg-oc-hiccup", "bsm-active", "high-duty-cycle", "input-current-limiting", "concurrent-mode-disable", "switcher-power-ok";
					};

					qcom,batif@1200 {
						reg = <0x1200>;
						interrupts = <0x2 0x12 0x0 0x1 0x2 0x12 0x2 0x3 0x2 0x12 0x3 0x3 0x2 0x12 0x4 0x3 0x2 0x12 0x5 0x3 0x2 0x12 0x6 0x3 0x2 0x12 0x7 0x3>;
						interrupt-names = "bat-temp", "bat-ov", "bat-low", "bat-therm-or-id-missing", "bat-terminal-missing", "buck-oc", "vph-ov";
					};

					qcom,usb@1300 {
						reg = <0x1300>;
						interrupts = <0x2 0x13 0x0 0x3 0x2 0x13 0x1 0x3 0x2 0x13 0x2 0x3 0x2 0x13 0x3 0x3 0x2 0x13 0x4 0x3 0x2 0x13 0x5 0x3 0x2 0x13 0x6 0x1 0x2 0x13 0x7 0x1>;
						interrupt-names = "usbin-collapse", "usbin-vashdn", "usbin-uv", "usbin-ov", "usbin-plugin", "usbin-revi-change", "usbin-src-change", "usbin-icl-change";
					};

					qcom,dc@1400 {
						reg = <0x1400>;
						interrupts = <0x2 0x14 0x1 0x3 0x2 0x14 0x2 0x3 0x2 0x14 0x3 0x3 0x2 0x14 0x4 0x3 0x2 0x14 0x5 0x3 0x2 0x14 0x6 0x1 0x2 0x14 0x7 0x1>;
						interrupt-names = "dcin-vashdn", "dcin-uv", "dcin-ov", "dcin-plugin", "dcin-revi", "dcin-pon", "dcin-en";
					};

					qcom,typec@1500 {
						reg = <0x1500>;
						interrupts = <0x2 0x15 0x0 0x1 0x2 0x15 0x1 0x1 0x2 0x15 0x2 0x1 0x2 0x15 0x3 0x1 0x2 0x15 0x4 0x1 0x2 0x15 0x5 0x1 0x2 0x15 0x6 0x1 0x2 0x15 0x7 0x1>;
						interrupt-names = "typec-or-rid-detect-change", "typec-vpd-detect", "typec-cc-state-change", "typec-vconn-oc", "typec-vbus-change", "typec-attach-detach", "typec-legacy-cable-detect", "typec-try-snk-src-detect";
					};

					qcom,misc@1600 {
						reg = <0x1600>;
						interrupts = <0x2 0x16 0x0 0x1 0x2 0x16 0x1 0x1 0x2 0x16 0x2 0x1 0x2 0x16 0x3 0x1 0x2 0x16 0x4 0x3 0x2 0x16 0x5 0x1 0x2 0x16 0x6 0x1 0x2 0x16 0x7 0x1>;
						interrupt-names = "wdog-snarl", "wdog-bark", "aicl-fail", "aicl-done", "smb-en", "imp-trigger", "temp-change", "temp-change-smb";
					};

					qcom,chg-sdam@b000 {
						reg = <0xb000>;
					};

					qcom,smb5-vbus {
						regulator-name = "smb5-vbus";
						phandle = <0x10>;
					};

					qcom,smb5-vconn {
						regulator-name = "smb5-vconn";
						phandle = <0x11>;
					};
				};

				qcom,usb-pdphy@1700 {
					compatible = "qcom,qpnp-pdphy";
					reg = <0x1700>;
					interrupts = <0x2 0x17 0x0 0x1 0x2 0x17 0x1 0x1 0x2 0x17 0x2 0x1 0x2 0x17 0x3 0x1 0x2 0x17 0x4 0x1 0x2 0x17 0x5 0x1 0x2 0x17 0x6 0x1 0x2 0x17 0x7 0x1>;
					interrupt-names = "sig-tx", "sig-rx", "msg-tx", "msg-rx", "msg-tx-failed", "msg-tx-discarded", "msg-rx-discarded", "fr-swap";
					#io-channel-cells = <0x1>;
					qcom,default-sink-caps = <0x1388 0xbb8 0x2328 0xbb8 0x2ee0 0x8ca>;
					vdd-pdphy-supply = <0xffffffff>;
					vbus-supply = <0x10>;
					vconn-supply = <0x11>;
					io-channels = <0x12 0x4 0x12 0x3 0x12 0xd 0x12 0x2 0x12 0x1f 0x12 0x1d 0x12 0x1e 0x12 0x0 0x12 0x20 0x12 0xc 0x12 0xb 0x12 0xa 0x12 0x1 0x12 0x7>;
					io-channel-names = "pd_active", "typec_cc_orientation", "connector_type", "typec_power_role", "pd_usb_suspend_supported", "typec_src_rp", "pd_in_hard_reset", "pr_current_max", "pr_swap", "pd_voltage_min", "pd_voltage_max", "real_type", "typec_mode", "pe_start";
					phandle = <0x1e>;
				};

				qcom,temp-alarm@2400 {
					compatible = "qcom,spmi-temp-alarm";
					reg = <0x2400>;
					interrupts = <0x2 0x24 0x0 0x3>;
					io-channels = <0xd 0x6>;
					io-channel-names = "thermal";
					#thermal-sensor-cells = <0x0>;
					qcom,temperature-threshold-set = <0x1>;
					phandle = <0x14>;
				};

				qpnp,qg {
					compatible = "qcom,pm7250b-qg";
					depends-on-supply = <0xffffffff>;
					#address-cells = <0x1>;
					#size-cells = <0x1>;
					qcom,vbatt-cutoff-mv = <0xd48>;
					qcom,vbatt-low-mv = <0xdac>;
					qcom,vbatt-low-cold-mv = <0xed8>;
					qcom,vbatt-empty-mv = <0xc80>;
					qcom,vbatt-empty-cold-mv = <0xc1c>;
					qcom,s3-entry-fifo-length = <0x2>;
					qcom,soc_decimal_rate = <0x0 0x20 0xa 0x1e 0x14 0x1c 0x1e 0x1c 0x28 0x1c 0x32 0x1c 0x3c 0x1c 0x46 0x1c 0x50 0x1c 0x5a 0x1a 0x5f 0xa 0x63 0x5>;
					status = "ok";
					#io-channel-cells = <0x1>;
					io-channels = <0xd 0x2a 0xd 0x4b 0x12 0x37 0x12 0x3f 0x12 0x40 0x12 0x39>;
					io-channel-names = "batt-therm", "batt-id", "input_current_limited", "recharge_soc", "force_recharge", "charge_done";
					qcom,qg-iterm-ma = <0x96>;
					qcom,hold-soc-while-full;
					qcom,linearize-soc;
					qcom,cl-feedback-on;
					qcom,tcss-enable;
					qcom,fvss-enable;
					qcom,fvss-vbatt-mv = <0xdac>;
					qcom,bass-enable;
					qcom,use-cp-iin-sns;
					phandle = <0xe>;

					qcom,qgauge@4800 {
						status = "okay";
						reg = <0x4800>;
						interrupts = <0x2 0x48 0x0 0x3 0x2 0x48 0x1 0x3 0x2 0x48 0x2 0x1 0x2 0x48 0x3 0x1 0x2 0x48 0x4 0x1>;
						interrupt-names = "qg-batt-missing", "qg-vbat-low", "qg-vbat-empty", "qg-fifo-done", "qg-good-ocv";
					};

					qcom,qg-sdam@b100 {
						status = "okay";
						reg = <0xb100>;
					};
				};

				clock-controller@5b00 {
					compatible = "qcom,spmi-clkdiv";
					reg = <0x5b00>;
					#clock-cells = <0x1>;
					qcom,num-clkdivs = <0x1>;
					clock-output-names = "pm7250b_div_clk1";
					clocks = <0xffffffff 0x0>;
					clock-names = "xo";
					assigned-clocks = <0x13 0x1>;
					assigned-clock-rates = <0x124f800>;
					phandle = <0x13>;
				};

				pinctrl@c000 {
					compatible = "qcom,pm7250b-gpio";
					reg = <0xc000>;
					gpio-controller;
					#gpio-cells = <0x2>;
					interrupt-controller;
					#interrupt-cells = <0x2>;
					phandle = <0x28>;

					disp_lcd_bias_en {

						disp_lcd_bias_en_default {
							pins = "gpio5";
							function = "func1";
							input-disable;
							output-enable;
							bias-disable;
							power-source = <0x0>;
							qcom,drive-strength = <0x2>;
							phandle = <0x29>;
						};
					};
				};

				vadc@3100 {
					compatible = "qcom,spmi-adc5";
					reg = <0x3100>;
					reg-names = "adc5-usr-base";
					#address-cells = <0x1>;
					#size-cells = <0x0>;
					interrupts = <0x2 0x31 0x0 0x1>;
					interrupt-names = "eoc-int-en-set";
					qcom,adc-vdd-reference = <0x753>;
					#io-channel-cells = <0x1>;
					io-channel-ranges;
					phandle = <0xd>;

					ref_gnd@0 {
						reg = <0x0>;
						label = "ref_gnd";
						qcom,pre-scaling = <0x1 0x1>;
					};

					vref_1p25@1 {
						reg = <0x1>;
						label = "vref_1p25";
						qcom,pre-scaling = <0x1 0x1>;
					};

					die_temp@2 {
						reg = <0x6>;
						label = "die_temp";
						qcom,pre-scaling = <0x1 0x1>;
					};

					vph_pwr@83 {
						reg = <0x83>;
						label = "vph_pwr";
						qcom,pre-scaling = <0x1 0x3>;
					};

					vbat_sns@84 {
						reg = <0x84>;
						label = "vbat_sns";
						qcom,pre-scaling = <0x1 0x3>;
					};

					usb_in_i_uv@7 {
						reg = <0x7>;
						label = "usb_in_i_uv";
						qcom,pre-scaling = <0x1 0x1>;
					};

					usb_in_v_div_16@8 {
						reg = <0x8>;
						label = "usb_in_v_div_16";
						qcom,pre-scaling = <0x1 0x10>;
					};

					chg_temp@9 {
						reg = <0x9>;
						label = "chg_temp";
						qcom,pre-scaling = <0x1 0x1>;
					};

					bat_therm@4a {
						reg = <0x4a>;
						label = "bat_therm";
						qcom,ratiometric;
						qcom,hw-settle-time = <0xc8>;
						qcom,pre-scaling = <0x1 0x1>;
					};

					bat_therm_30k@2a {
						reg = <0x2a>;
						label = "bat_therm_30k";
						qcom,ratiometric;
						qcom,hw-settle-time = <0xc8>;
						qcom,pre-scaling = <0x1 0x1>;
					};

					bat_therm_400k@6a {
						reg = <0x6a>;
						label = "bat_therm_400k";
						qcom,ratiometric;
						qcom,hw-settle-time = <0xc8>;
						qcom,pre-scaling = <0x1 0x1>;
					};

					bat_id@4b {
						reg = <0x4b>;
						label = "bat_id";
						qcom,ratiometric;
						qcom,hw-settle-time = <0xc8>;
						qcom,pre-scaling = <0x1 0x1>;
					};

					smb1390_therm@e {
						reg = <0xe>;
						label = "smb1390_therm";
						qcom,hw-settle-time = <0xc8>;
						qcom,pre-scaling = <0x1 0x1>;
						qcom,scale-fn-type = <0x10>;
					};

					chg_sbux@99 {
						reg = <0x99>;
						label = "chg_sbux";
						qcom,pre-scaling = <0x1 0x3>;
					};

					mid_chg_div6@1e {
						reg = <0x1e>;
						label = "chg_mid";
						qcom,pre-scaling = <0x1 0x6>;
					};

					charger_skin_therm@4d {
						reg = <0x4d>;
						label = "charger_skin_therm";
						qcom,ratiometric;
						qcom,hw-settle-time = <0xc8>;
						qcom,pre-scaling = <0x1 0x1>;
					};

					conn_therm@4f {
						reg = <0x4f>;
						label = "conn_therm";
						qcom,ratiometric;
						qcom,hw-settle-time = <0xc8>;
						qcom,pre-scaling = <0x1 0x1>;
					};
				};

				adc_tm@3500 {
					compatible = "qcom,spmi-adc-tm5";
					reg = <0x3500>;
					interrupts = <0x2 0x35 0x0 0x1>;
					interrupt-names = "pm-adc-tm5";
					#address-cells = <0x1>;
					#size-cells = <0x0>;
					#thermal-sensor-cells = <0x1>;
					status = "ok";
					phandle = <0x16>;

					charger_skin_therm@4d {
						reg = <0x0>;
						io-channels = <0xd 0x4d>;
						qcom,ratiometric;
						qcom,hw-settle-time-us = <0xc8>;
					};

					conn_therm@4f {
						reg = <0x1>;
						io-channels = <0xd 0x4f>;
						qcom,ratiometric;
						qcom,hw-settle-time-us = <0xc8>;
					};
				};

				bcl@1d00 {
					compatible = "qcom,bcl-v5";
					reg = <0x1d00>;
					interrupts = <0x2 0x1d 0x0 0x0 0x2 0x1d 0x1 0x0 0x2 0x1d 0x2 0x0>;
					interrupt-names = "bcl-lvl0", "bcl-lvl1", "bcl-lvl2";
					#thermal-sensor-cells = <0x1>;
					phandle = <0x15>;
				};

				bcl-soc {
					compatible = "qcom,msm-bcl-soc";
					#thermal-sensor-cells = <0x0>;
					phandle = <0x2a>;
				};
			};

			qcom,pm7250b@3 {
				compatible = "qcom,spmi-pmic";
				reg = <0x3 0x0>;
				#address-cells = <0x1>;
				#size-cells = <0x0>;

				qcom,vibrator@5300 {
					compatible = "qcom,qpnp-vibrator-ldo";
					reg = <0x5300>;
					qcom,vib-ldo-volt-uv = <0x2dc6c0>;
					qcom,disable-overdrive;
					phandle = <0x2b>;
				};
			};
		};
	};

	fragment@15 {
		target = <0xffffffff>;

		__overlay__ {

			pm7250b-tz {
				polling-delay-passive = <0x64>;
				polling-delay = <0x0>;
				thermal-sensors = <0x14>;
				phandle = <0x2c>;

				trips {

					trip0 {
						temperature = <0x17318>;
						hysteresis = <0x0>;
						type = "passive";
						phandle = <0x17>;
					};

					trip1 {
						temperature = <0x1c138>;
						hysteresis = <0x0>;
						type = "passive";
						phandle = <0x18>;
					};

					trip2 {
						temperature = <0x23668>;
						hysteresis = <0x0>;
						type = "passive";
					};
				};
			};

			pm7250b-ibat-lvl0 {
				polling-delay-passive = <0x0>;
				polling-delay = <0x0>;
				thermal-sensors = <0x15 0x0>;

				trips {

					ibat-lvl0 {
						temperature = <0x157c>;
						hysteresis = <0xc8>;
						type = "passive";
						phandle = <0x2d>;
					};
				};
			};

			pm7250b-ibat-lvl1 {
				polling-delay-passive = <0x0>;
				polling-delay = <0x0>;
				thermal-sensors = <0x15 0x1>;

				trips {

					ibat-lvl1 {
						temperature = <0x1770>;
						hysteresis = <0xc8>;
						type = "passive";
						phandle = <0x2e>;
					};
				};
			};

			pm7250b-bcl-lvl0 {
				polling-delay-passive = <0x64>;
				polling-delay = <0x0>;
				thermal-sensors = <0x15 0x5>;

				trips {

					b-bcl-lvl0 {
						temperature = <0x1>;
						hysteresis = <0x1>;
						type = "passive";
						phandle = <0x1a>;
					};
				};
			};

			pm7250b-bcl-lvl1 {
				polling-delay-passive = <0x64>;
				polling-delay = <0x0>;
				thermal-sensors = <0x15 0x6>;

				trips {

					b-bcl-lvl1 {
						temperature = <0x1>;
						hysteresis = <0x1>;
						type = "passive";
						phandle = <0x1b>;
					};
				};
			};

			pm7250b-bcl-lvl2 {
				polling-delay-passive = <0x64>;
				polling-delay = <0x0>;
				thermal-sensors = <0x15 0x7>;

				trips {

					b-bcl-lvl2 {
						temperature = <0x1>;
						hysteresis = <0x1>;
						type = "passive";
						phandle = <0x1c>;
					};
				};
			};

			socd {
				polling-delay-passive = <0x64>;
				polling-delay = <0x0>;

				trips {

					thermal-engine-trip {
						temperature = <0x64>;
						hysteresis = <0x0>;
						type = "passive";
					};

					thermal-hal-trip {
						temperature = <0x64>;
						hysteresis = <0x0>;
						type = "passive";
					};

					soc-trip {
						temperature = <0x5a>;
						hysteresis = <0x0>;
						type = "passive";
						phandle = <0x19>;
					};
				};
			};
		};
	};

	fragment@16 {
		target = <0xffffffff>;

		__overlay__ {

			charger-therm-usr {
				polling-delay-passive = <0x0>;
				polling-delay = <0x0>;
				thermal-governor = "user_space";
				thermal-sensors = <0x16 0x0>;
				wake-capable-sensor;

				trips {

					active-config0 {
						temperature = <0x1e848>;
						hysteresis = <0x3e8>;
						type = "passive";
					};
				};
			};

			conn-therm-usr {
				polling-delay-passive = <0x0>;
				polling-delay = <0x0>;
				thermal-governor = "user_space";
				thermal-sensors = <0x16 0x1>;
				wake-capable-sensor;

				trips {

					active-config0 {
						temperature = <0x1e848>;
						hysteresis = <0x3e8>;
						type = "passive";
					};
				};
			};
		};
	};

	fragment@17 {
		target = <0xffffffff>;

		__overlay__ {

			pm7250b-tz {

				cooling-maps {

					trip0_bat {
						trip = <0x17>;
						cooling-device = <0x12 0x9 0x9>;
					};

					trip1_bat {
						trip = <0x18>;
						cooling-device = <0x12 0xa 0xa>;
					};
				};
			};

			socd {

				cooling-maps {

					soc_cpu4 {
						trip = <0x19>;
						cooling-device = <0xffffffff 0x1 0x1>;
					};

					soc_cpu5 {
						trip = <0x19>;
						cooling-device = <0xffffffff 0x1 0x1>;
					};

					soc_cpu6 {
						trip = <0x19>;
						cooling-device = <0xffffffff 0x1 0x1>;
					};

					soc_cpu7 {
						trip = <0x19>;
						cooling-device = <0xffffffff 0x1 0x1>;
					};
				};
			};

			pm7250b-bcl-lvl0 {

				cooling-maps {

					lbat0_cpufreq4 {
						trip = <0x1a>;
						cooling-device = <0xffffffff 0x2 0x2>;
					};

					lbat0_cpu6 {
						trip = <0x1a>;
						cooling-device = <0xffffffff 0x1 0x1>;
					};

					lbat0_cpu7 {
						trip = <0x1a>;
						cooling-device = <0xffffffff 0x1 0x1>;
					};

					lbat0_gpu {
						trip = <0x1a>;
						cooling-device = <0xffffffff 0x2 0x2>;
					};

					lbat0_cdsp {
						trip = <0x1a>;
						cooling-device = <0xffffffff 0x2 0x2>;
					};
				};
			};

			pm7250b-bcl-lvl1 {

				cooling-maps {

					lbat1_cpu4 {
						trip = <0x1b>;
						cooling-device = <0xffffffff 0x1 0x1>;
					};

					lbat1_cpu5 {
						trip = <0x1b>;
						cooling-device = <0xffffffff 0x1 0x1>;
					};

					lbat1_gpu {
						trip = <0x1b>;
						cooling-device = <0xffffffff 0x4 0x4>;
					};

					lbat1_cdsp {
						trip = <0x1b>;
						cooling-device = <0xffffffff 0x4 0x4>;
					};
				};
			};

			pm7250b-bcl-lvl2 {

				cooling-maps {

					lbat2_gpu {
						trip = <0x1c>;
						cooling-device = <0xffffffff 0x4 0xffffffff>;
					};

					lbat2_cdsp {
						trip = <0x1c>;
						cooling-device = <0xffffffff 0x4 0x4>;
					};
				};
			};
		};
	};

	fragment@18 {
		target = <0xffffffff>;

		__overlay__ {

			qcom,battery-data {
				qcom,batt-id-range-pct = <0xf>;
				phandle = <0xf>;

				qcom,ATL466271_3300mAh {
					qcom,max-voltage-uv = <0x432380>;
					qcom,fg-cc-cv-threshold-uv = <0x42fc70>;
					qcom,fastchg-current-ma = <0x1f40>;
					qcom,batt-id-kohm = <0x18>;
					qcom,battery-beta = <0x109a>;
					qcom,battery-therm-kohm = <0x64>;
					qcom,battery-type = "ATL466271_3300mAh_averaged_MasterSlave_Jun12th2019";
					qcom,qg-batt-profile-ver = <0x64>;
					qcom,jeita-fcc-ranges = <0x0 0x64 0x186a00 0x65 0xc8 0x30d400 0xc9 0x1c2 0x7a1200 0x1c3 0x226 0x186a00>;
					qcom,jeita-fv-ranges = <0x0 0x64 0x432380 0x65 0xc8 0x432380 0xc9 0x1c2 0x432380 0x1c3 0x226 0x3dcc50>;
					qcom,step-chg-ranges = <0x3567e0 0x3d0900 0x7a1200 0x3d0901 0x401640 0x5b8d80 0x401641 0x432380 0x3d0900>;
					qcom,ocv-based-step-chg;
					qcom,jeita-soft-thresholds = <0x4ccc 0x20b8>;
					qcom,jeita-hard-thresholds = <0x58cd 0x181d>;
					qcom,jeita-soft-hys-thresholds = <0x48d4 0x23c0>;
					qcom,jeita-soft-fcc-ua = <0x186a00 0x186a00>;
					qcom,jeita-soft-fv-uv = <0x432380 0x3dcc50>;

					qcom,fcc1-temp-lut {
						qcom,lut-col-legend = <0x0 0xa 0x19 0x28 0x32>;
						qcom,lut-data = <0xc77 0xcbc 0xcf8 0xd1a 0xd26>;
					};

					qcom,fcc2-temp-lut {
						qcom,lut-col-legend = <0xfffffff6 0x0 0xa 0x19 0x28 0x32>;
						qcom,lut-data = <0xceb 0xced 0xcfc 0xd04 0xd02 0xcfe>;
					};

					qcom,pc-temp-v1-lut {
						qcom,lut-col-legend = <0x0 0xa 0x19 0x28 0x32>;
						qcom,lut-row-legend = <0x2710 0x2648 0x2580 0x24b8 0x23f0 0x2328 0x2260 0x2198 0x20d0 0x2008 0x1f40 0x1e78 0x1db0 0x1ce8 0x1c20 0x1b58 0x1a90 0x19c8 0x1900 0x1838 0x1770 0x16a8 0x15e0 0x1518 0x1450 0x1388 0x12c0 0x11f8 0x1130 0x1068 0xfa0 0xed8 0xe10 0xd48 0xc80 0xbb8 0xaf0 0xa28 0x960 0x898 0x7d0 0x708 0x640 0x578 0x4b0 0x3e8 0x384 0x320 0x2bc 0x258 0x1f4 0x190 0x12c 0xc8 0x64 0x0>;
						qcom,lut-data = <0xaabe 0xab31 0xab85 0xaba1 0xaba6 0xa9d1 0xaa55 0xaaba 0xaac9 0xaacb 0xa8e5 0xa974 0xa9e1 0xa9f5 0xa9f6 0xa7fb 0xa88e 0xa903 0xa91e 0xa923 0xa717 0xa7a6 0xa81e 0xa83e 0xa847 0xa636 0xa6bf 0xa734 0xa755 0xa762 0xa558 0xa5d9 0xa64d 0xa66e 0xa67c 0xa47d 0xa4f6 0xa565 0xa587 0xa596 0xa3a6 0xa418 0xa481 0xa4a1 0xa4b1 0xa2d4 0xa33d 0xa39e 0xa3bd 0xa3cd 0xa204 0xa266 0xa2bf 0xa2da 0xa2e9 0xa13e 0xa190 0xa1e6 0xa1fb 0xa209 0xa08f 0xa0c7 0xa110 0xa11f 0xa12d 0x9fef 0xa01b 0xa043 0xa04b 0xa057 0x9f34 0x9f77 0x9f7f 0x9f81 0x9f88 0x9e33 0x9eb1 0x9ebe 0x9ebf 0x9ec2 0x9d2b 0x9db3 0x9df2 0x9dfa 0x9e00 0x9c6f 0x9cc8 0x9d20 0x9d31 0x9d43 0x9be1 0x9c2a 0x9c67 0x9c75 0x9c8c 0x9b5a 0x9ba5 0x9bd5 0x9bd6 0x9be5 0x9ad5 0x9af4 0x9b3e 0x9b3e 0x9b44 0x9a4a 0x99ea 0x9a67 0x9a7a 0x9a82 0x9997 0x98f7 0x995c 0x9976 0x9983 0x9891 0x986a 0x9890 0x9896 0x989e 0x97b9 0x9802 0x9804 0x97fd 0x9801 0x975c 0x979e 0x978e 0x977f 0x9782 0x9720 0x973a 0x971e 0x970c 0x970b 0x96e4 0x96dd 0x96b8 0x96a6 0x969f 0x96a6 0x9688 0x965b 0x9647 0x963c 0x9668 0x963b 0x9606 0x95ec 0x95df 0x962d 0x95f7 0x95ba 0x9599 0x958a 0x95f4 0x95ba 0x9575 0x954f 0x953d 0x95c1 0x9584 0x9537 0x950c 0x94f6 0x9594 0x9554 0x94ff 0x94cf 0x94b4 0x956b 0x952b 0x94cf 0x949b 0x9479 0x9546 0x9502 0x94a1 0x9468 0x943f 0x9526 0x94df 0x9474 0x942d 0x93f9 0x94ff 0x94b7 0x9446 0x93ed 0x93a8 0x94ba 0x9476 0x9407 0x93a1 0x934f 0x9456 0x940f 0x93aa 0x9341 0x92ee 0x93e8 0x939c 0x933c 0x92d3 0x9282 0x9368 0x931f 0x92c3 0x9251 0x9200 0x92d8 0x9292 0x9239 0x91be 0x916c 0x9233 0x91e7 0x9196 0x9120 0x90cf 0x91ad 0x9162 0x910f 0x90ad 0x9064 0x9162 0x911c 0x90c5 0x9070 0x9036 0x914d 0x9107 0x90b3 0x905e 0x9023 0x9138 0x90fa 0x90a3 0x9051 0x9014 0x9120 0x90de 0x908d 0x9033 0x8fed 0x90bd 0x905a 0x900f 0x8f73 0x8f0f 0x8f42 0x8ee2 0x8eae 0x8dfb 0x8d92 0x8d63 0x8cf6 0x8cc9 0x8c13 0x8ba7 0x8af6 0x8a79 0x8a63 0x899d 0x892c 0x87a9 0x870e 0x870e 0x863a 0x85c2 0x8279 0x8194 0x81c9 0x80dd 0x8053 0x7530 0x7530 0x7530 0x7530 0x7530>;
					};

					qcom,pc-temp-v2-lut {
						qcom,lut-col-legend = <0xfffffff6 0x0 0xa 0x19 0x28 0x32>;
						qcom,lut-row-legend = <0x2710 0x2648 0x2580 0x24b8 0x23f0 0x2328 0x2260 0x2198 0x20d0 0x2008 0x1f40 0x1e78 0x1db0 0x1ce8 0x1c20 0x1b58 0x1a90 0x19c8 0x1900 0x1838 0x1770 0x16a8 0x15e0 0x1518 0x1450 0x1388 0x12c0 0x11f8 0x1130 0x1068 0xfa0 0xed8 0xe10 0xd48 0xc80 0xbb8 0xaf0 0xa28 0x960 0x898 0x7d0 0x708 0x640 0x578 0x4b0 0x3e8 0x384 0x320 0x2bc 0x258 0x1f4 0x190 0x12c 0xc8 0x64 0x0>;
						qcom,lut-data = <0xabc7 0xabae 0xab9a 0xab81 0xab4f 0xab3b 0xaa5e 0xaa7f 0xaa93 0xaa8f 0xaa61 0xaa4c 0xa90f 0xa961 0xa992 0xa9a0 0xa977 0xa962 0xa7dc 0xa854 0xa89a 0xa8b4 0xa88e 0xa87a 0xa6c0 0xa759 0xa7a9 0xa7cc 0xa7a9 0xa797 0xa5c0 0xa664 0xa6ba 0xa6e4 0xa6c3 0xa6b3 0xa4ec 0xa56e 0xa5ce 0xa5fa 0xa5da 0xa5cb 0xa424 0xa47e 0xa4e4 0xa511 0xa4f1 0xa4e2 0xa32c 0xa399 0xa3fe 0xa42b 0xa40b 0xa3fc 0xa1f2 0xa2be 0xa31b 0xa347 0xa326 0xa317 0xa113 0xa1e8 0xa23b 0xa266 0xa245 0xa236 0xa0c1 0xa113 0xa15e 0xa188 0xa166 0xa159 0xa080 0xa042 0xa086 0xa0ae 0xa08c 0xa07f 0x9fc8 0x9f80 0x9fc3 0x9fe2 0x9fbd 0x9fad 0x9dff 0x9ecd 0x9f10 0x9f20 0x9ef6 0x9ee0 0x9c62 0x9e0a 0x9e4d 0x9e59 0x9e2f 0x9e18 0x9b6c 0x9d1d 0x9d64 0x9d7f 0x9d60 0x9d55 0x9aa1 0x9c1f 0x9c72 0x9caa 0x9c97 0x9c98 0x99ee 0x9b36 0x9ba1 0x9bf6 0x9be8 0x9be9 0x9950 0x9a5b 0x9ae4 0x9b57 0x9b4a 0x9b46 0x98a2 0x9989 0x9a20 0x9a9f 0x9a94 0x9a8e 0x97b0 0x98bc 0x9940 0x99a8 0x99a0 0x999b 0x96b8 0x97fc 0x9869 0x98b1 0x98aa 0x98a8 0x961a 0x975b 0x97bd 0x97fa 0x97f7 0x97f5 0x95a6 0x96d1 0x972b 0x9760 0x9763 0x9762 0x9552 0x964d 0x96aa 0x96dd 0x96e3 0x96e1 0x9514 0x95bf 0x9635 0x966a 0x9671 0x966f 0x94e1 0x953c 0x95cc 0x9603 0x960a 0x9607 0x94ae 0x94e0 0x956d 0x95a4 0x95aa 0x95a7 0x947e 0x949b 0x9516 0x954d 0x9550 0x954c 0x9450 0x9464 0x94c2 0x94fc 0x94fe 0x94f9 0x9425 0x9436 0x946c 0x94b0 0x94b3 0x94ae 0x93fa 0x940d 0x9421 0x9469 0x946b 0x9465 0x93cc 0x93e5 0x93ee 0x9425 0x9426 0x941a 0x939d 0x93bf 0x93c7 0x93e3 0x93e2 0x93cd 0x936b 0x9395 0x939e 0x939d 0x938f 0x9371 0x9338 0x9367 0x9373 0x9353 0x9324 0x92f9 0x92ff 0x9332 0x9342 0x9305 0x92b7 0x9281 0x92ba 0x92f3 0x9300 0x92b7 0x925d 0x9222 0x9268 0x92a6 0x92ab 0x9265 0x920a 0x91cd 0x9209 0x9249 0x9247 0x9206 0x91aa 0x916c 0x9194 0x91c9 0x91ca 0x9195 0x913a 0x90f9 0x9118 0x9139 0x913d 0x910f 0x90b5 0x9073 0x90a3 0x90a2 0x90a1 0x907b 0x901f 0x8fde 0x9044 0x9036 0x904b 0x902c 0x8fe9 0x8fb0 0x8ff7 0x8ff9 0x9023 0x9015 0x8fd2 0x8f9a 0x8fcc 0x8fdb 0x900b 0x9003 0x8fc1 0x8f8d 0x8f99 0x8fb2 0x8fee 0x8feb 0x8fab 0x8f72 0x8f47 0x8f71 0x8fa7 0x8fab 0x8f54 0x8ef5 0x8e7b 0x8ec7 0x8ec2 0x8ec8 0x8e26 0x8da8 0x8ce2 0x8d4d 0x8d1f 0x8d25 0x8c61 0x8bd5 0x8aab 0x8b3f 0x8afb 0x8b0c 0x8a2a 0x898b 0x87ce 0x8898 0x882f 0x885d 0x8749 0x8695 0x83f8 0x84e8 0x848f 0x84cc 0x837a 0x8280 0x7e9c 0x7fc7 0x7f37 0x7f8a 0x7c60 0x7a4f 0x6e37 0x709f 0x6b82 0x6fa3 0x6ca6 0x6b7e>;
					};

					qcom,pc-temp-z1-lut {
						qcom,lut-col-legend = <0x0 0xa 0x19 0x28 0x32>;
						qcom,lut-row-legend = <0x2710 0x2648 0x2580 0x24b8 0x23f0 0x2328 0x2260 0x2198 0x20d0 0x2008 0x1f40 0x1e78 0x1db0 0x1ce8 0x1c20 0x1b58 0x1a90 0x19c8 0x1900 0x1838 0x1770 0x16a8 0x15e0 0x1518 0x1450 0x1388 0x12c0 0x11f8 0x1130 0x1068 0xfa0 0xed8 0xe10 0xd48 0xc80 0xbb8 0xaf0 0xa28 0x960 0x898 0x7d0 0x708 0x640 0x578 0x4b0 0x3e8 0x384 0x320 0x2bc 0x258 0x1f4 0x190 0x12c 0xc8 0x64 0x0>;
						qcom,lut-data = <0x2dfa 0x2b9f 0x290c 0x27d8 0x278b 0x2e1a 0x2bb9 0x2953 0x2821 0x27ce 0x2e1e 0x2bc0 0x2955 0x2823 0x27cf 0x2e1d 0x2baf 0x294a 0x2823 0x27cf 0x2e10 0x2ba2 0x293d 0x281e 0x27cd 0x2e01 0x2b92 0x2931 0x2818 0x27c9 0x2df5 0x2b7b 0x2929 0x2813 0x27c6 0x2deb 0x2b6c 0x2922 0x280f 0x27c4 0x2ddf 0x2b67 0x291c 0x280b 0x27c2 0x2dd7 0x2b64 0x2918 0x280a 0x27c1 0x2dd2 0x2b64 0x2915 0x2809 0x27bf 0x2dce 0x2b64 0x2912 0x2808 0x27be 0x2dc9 0x2b64 0x2910 0x2808 0x27bd 0x2dc5 0x2b61 0x290f 0x2807 0x27bd 0x2dc2 0x2b5b 0x290e 0x2807 0x27bc 0x2db8 0x2b59 0x290c 0x2805 0x27bc 0x2dad 0x2b57 0x290b 0x2805 0x27bc 0x2dad 0x2b57 0x290a 0x2805 0x27bc 0x2db8 0x2b59 0x290a 0x2806 0x27be 0x2dc2 0x2b5d 0x290d 0x2808 0x27bf 0x2dce 0x2b62 0x2911 0x280c 0x27c1 0x2ddd 0x2b6a 0x2915 0x280e 0x27c3 0x2de0 0x2b72 0x291a 0x2810 0x27c5 0x2dd9 0x2b78 0x291f 0x2812 0x27c7 0x2dd4 0x2b7d 0x2924 0x2814 0x27c9 0x2dd5 0x2b7e 0x2929 0x2818 0x27cb 0x2dd9 0x2b7c 0x292e 0x281b 0x27ce 0x2ddc 0x2b7b 0x2934 0x2820 0x27d2 0x2ddf 0x2b7d 0x2939 0x2824 0x27d5 0x2de3 0x2b81 0x293e 0x2828 0x27d8 0x2de6 0x2b86 0x2944 0x282d 0x27db 0x2dea 0x2b92 0x294b 0x2830 0x27de 0x2dee 0x2b9d 0x2953 0x2834 0x27e1 0x2df9 0x2b9d 0x2958 0x2838 0x27e5 0x2e05 0x2b99 0x295d 0x283d 0x27e9 0x2e0d 0x2b97 0x2962 0x2842 0x27ed 0x2e14 0x2ba1 0x2968 0x2848 0x27f1 0x2e1b 0x2bae 0x296e 0x284d 0x27f5 0x2e21 0x2bb1 0x2974 0x2852 0x27f9 0x2e28 0x2bb2 0x297b 0x2856 0x27fc 0x2e2b 0x2bb4 0x2981 0x285a 0x27ff 0x2e2d 0x2bbf 0x2986 0x285f 0x2803 0x2e2f 0x2bc8 0x298c 0x2864 0x2806 0x2e32 0x2bc6 0x2992 0x2866 0x2808 0x2e2c 0x2bcf 0x2998 0x2868 0x2809 0x2e2c 0x2bd4 0x299f 0x286b 0x280a 0x2e36 0x2bd9 0x29a4 0x286c 0x280c 0x2e28 0x2be0 0x29a2 0x286e 0x280d 0x2e37 0x2bd8 0x29a6 0x2872 0x2811 0x2e50 0x2bd5 0x29af 0x2876 0x2815 0x2e39 0x2be1 0x29b1 0x287a 0x2819 0x2e48 0x2bf3 0x29b6 0x2880 0x281e 0x2e6d 0x2bf9 0x29c0 0x2886 0x2823 0x2e7a 0x2c18 0x29ce 0x288e 0x282a 0x2e7a 0x2c18 0x29ce 0x288e 0x282a 0x2e7a 0x2c18 0x29ce 0x288e 0x282a>;
					};

					qcom,pc-temp-z2-lut {
						qcom,lut-col-legend = <0x0 0xa 0x19 0x28 0x32>;
						qcom,lut-row-legend = <0x2710 0x2648 0x2580 0x24b8 0x23f0 0x2328 0x2260 0x2198 0x20d0 0x2008 0x1f40 0x1e78 0x1db0 0x1ce8 0x1c20 0x1b58 0x1a90 0x19c8 0x1900 0x1838 0x1770 0x16a8 0x15e0 0x1518 0x1450 0x1388 0x12c0 0x11f8 0x1130 0x1068 0xfa0 0xed8 0xe10 0xd48 0xc80 0xbb8 0xaf0 0xa28 0x960 0x898 0x7d0 0x708 0x640 0x578 0x4b0 0x3e8 0x384 0x320 0x2bc 0x258 0x1f4 0x190 0x12c 0xc8 0x64 0x0>;
						qcom,lut-data = <0x26a6 0x261d 0x2732 0x277a 0x2869 0x26b9 0x26cc 0x271e 0x27b4 0x27f2 0x26d3 0x2713 0x2744 0x278c 0x27e6 0x26e9 0x2709 0x2755 0x275f 0x27dd 0x26e4 0x26f7 0x274f 0x2761 0x27dd 0x26cc 0x26f0 0x2742 0x2774 0x27e0 0x26b5 0x26ec 0x272c 0x2784 0x27e6 0x26a6 0x26ea 0x2704 0x278f 0x27f0 0x269a 0x26ed 0x26f3 0x2799 0x27ff 0x2697 0x26f3 0x26fb 0x27a2 0x2810 0x269f 0x26f7 0x2706 0x27ab 0x2826 0x26ab 0x26fa 0x270c 0x27b0 0x2835 0x26b4 0x26ff 0x2713 0x27b0 0x283e 0x26bb 0x277f 0x271a 0x27af 0x2843 0x26c3 0x2841 0x2721 0x27b4 0x283f 0x26d1 0x284f 0x2725 0x27bb 0x2838 0x26dd 0x27a8 0x2724 0x27ba 0x2836 0x26de 0x272c 0x271f 0x27b3 0x2836 0x26d8 0x2723 0x271d 0x27ae 0x2837 0x26d4 0x271d 0x2726 0x27c2 0x2843 0x26d4 0x271f 0x2737 0x27e4 0x285b 0x26d7 0x2741 0x2761 0x27e9 0x285e 0x26dc 0x275f 0x27ab 0x27dd 0x2839 0x26ea 0x275a 0x27c4 0x27c9 0x2806 0x26f5 0x274b 0x279d 0x278b 0x27c4 0x26f6 0x2744 0x276e 0x2742 0x2781 0x26f4 0x2744 0x2756 0x2739 0x2776 0x26f4 0x2745 0x2745 0x273e 0x2781 0x26f5 0x273e 0x2741 0x2746 0x278f 0x26f7 0x2731 0x274c 0x2750 0x279d 0x26f8 0x272d 0x275b 0x275d 0x27ae 0x26fa 0x2736 0x276b 0x2772 0x27c4 0x26fc 0x2744 0x277c 0x2791 0x27e0 0x26ff 0x2750 0x278f 0x27b3 0x2803 0x2704 0x275d 0x27a4 0x27de 0x2835 0x2708 0x2767 0x27b8 0x2804 0x2869 0x270d 0x276f 0x27c7 0x2817 0x288c 0x2713 0x2776 0x27d3 0x2824 0x28a9 0x271c 0x2782 0x27e0 0x282f 0x28b1 0x2727 0x2792 0x27f2 0x283a 0x28a3 0x2728 0x2799 0x27fd 0x2842 0x2896 0x271e 0x2788 0x27ec 0x2844 0x2895 0x2718 0x277a 0x27d0 0x2843 0x2890 0x2716 0x277a 0x27ca 0x283a 0x2879 0x274a 0x278c 0x27d7 0x283b 0x2859 0x274d 0x278c 0x27dc 0x2845 0x2878 0x2746 0x2781 0x27e6 0x283d 0x2877 0x2744 0x276d 0x27df 0x2870 0x2898 0x2737 0x2778 0x27f3 0x289d 0x28d4 0x26f4 0x27ab 0x27f4 0x281c 0x280e 0x2761 0x2791 0x27bb 0x27d1 0x27ea 0x2732 0x276f 0x2790 0x27b1 0x27bf 0x2709 0x273b 0x2777 0x2790 0x27a2 0x266c 0x2709 0x2749 0x2763 0x274f 0x266c 0x2709 0x2749 0x2763 0x274f 0x266c 0x2709 0x2749 0x2763 0x274f>;
					};

					qcom,pc-temp-z3-lut {
						qcom,lut-col-legend = <0x0 0xa 0x19 0x28 0x32>;
						qcom,lut-row-legend = <0x2710 0x2648 0x2580 0x24b8 0x23f0 0x2328 0x2260 0x2198 0x20d0 0x2008 0x1f40 0x1e78 0x1db0 0x1ce8 0x1c20 0x1b58 0x1a90 0x19c8 0x1900 0x1838 0x1770 0x16a8 0x15e0 0x1518 0x1450 0x1388 0x12c0 0x11f8 0x1130 0x1068 0xfa0 0xed8 0xe10 0xd48 0xc80 0xbb8 0xaf0 0xa28 0x960 0x898 0x7d0 0x708 0x640 0x578 0x4b0 0x3e8 0x384 0x320 0x2bc 0x258 0x1f4 0x190 0x12c 0xc8 0x64 0x0>;
						qcom,lut-data = <0x4c2c 0x4bf4 0x4baa 0x4b97 0x4b71 0x4caa 0x4c40 0x4bca 0x4b99 0x4b8c 0x4cdd 0x4c68 0x4be2 0x4ba2 0x4b94 0x4cfa 0x4c72 0x4beb 0x4ba9 0x4b99 0x4cfc 0x4c77 0x4be8 0x4ba9 0x4b99 0x4cf8 0x4c76 0x4be3 0x4ba7 0x4b97 0x4cf5 0x4c6e 0x4bdd 0x4ba4 0x4b94 0x4cf3 0x4c65 0x4bd6 0x4ba0 0x4b91 0x4cf1 0x4c5d 0x4bd1 0x4b9b 0x4b8d 0x4cec 0x4c55 0x4bce 0x4b99 0x4b8c 0x4ce0 0x4c4f 0x4bcc 0x4b98 0x4b8b 0x4cd1 0x4c49 0x4bc9 0x4b97 0x4b8a 0x4cc1 0x4c45 0x4bc5 0x4b97 0x4b89 0x4cb0 0x4c46 0x4bc3 0x4b97 0x4b88 0x4ca9 0x4c49 0x4bc2 0x4b96 0x4b87 0x4cb0 0x4c49 0x4bc2 0x4b95 0x4b83 0x4cb7 0x4c43 0x4bc2 0x4b94 0x4b81 0x4cb6 0x4c3d 0x4bc2 0x4b93 0x4b7f 0x4cac 0x4c36 0x4bc2 0x4b91 0x4b7d 0x4ca5 0x4c2e 0x4bbe 0x4b8d 0x4b7b 0x4ca2 0x4c2d 0x4bb9 0x4b87 0x4b78 0x4ca0 0x4c3b 0x4bbd 0x4b89 0x4b7a 0x4ca2 0x4c47 0x4bca 0x4b9b 0x4b8b 0x4cb0 0x4c40 0x4bd7 0x4ba9 0x4b9a 0x4cbb 0x4c2f 0x4be4 0x4bb0 0x4b9d 0x4cb6 0x4c2b 0x4bed 0x4bb4 0x4b9f 0x4caa 0x4c3f 0x4bed 0x4bb4 0x4b9f 0x4ca3 0x4c53 0x4bea 0x4bad 0x4b9c 0x4ca2 0x4c53 0x4be6 0x4ba8 0x4b99 0x4ca2 0x4c4f 0x4be1 0x4ba6 0x4b96 0x4ca3 0x4c4a 0x4bda 0x4ba4 0x4b93 0x4ca5 0x4c44 0x4bd5 0x4ba2 0x4b8f 0x4ca6 0x4c3d 0x4bd1 0x4b9e 0x4b8c 0x4ca5 0x4c38 0x4bcd 0x4b9a 0x4b88 0x4ca2 0x4c34 0x4bc9 0x4b95 0x4b83 0x4c9f 0x4c31 0x4bc6 0x4b92 0x4b80 0x4c9b 0x4c2f 0x4bc5 0x4b92 0x4b82 0x4c97 0x4c2c 0x4bc4 0x4b93 0x4b88 0x4c93 0x4c29 0x4bc3 0x4b94 0x4b8b 0x4c8d 0x4c26 0x4bc1 0x4b96 0x4b8b 0x4c89 0x4c22 0x4bbe 0x4b97 0x4b8b 0x4c88 0x4c1f 0x4bba 0x4b98 0x4b8b 0x4c84 0x4c1b 0x4bb7 0x4b99 0x4b8b 0x4c7b 0x4c19 0x4bb9 0x4b9a 0x4b8d 0x4c57 0x4c0a 0x4bb6 0x4b96 0x4b8d 0x4c49 0x4bfa 0x4ba8 0x4b89 0x4b79 0x4c45 0x4bf8 0x4ba5 0x4b83 0x4b76 0x4c43 0x4bee 0x4ba3 0x4b7c 0x4b70 0x4c21 0x4bea 0x4b9f 0x4b78 0x4b70 0x4bc9 0x4bee 0x4ba3 0x4b8e 0x4b82 0x4c3a 0x4bf2 0x4bb0 0x4b91 0x4b83 0x4c34 0x4bf4 0x4bb2 0x4b91 0x4b84 0x4c32 0x4bf7 0x4bb5 0x4b92 0x4b86 0x4c17 0x4bfb 0x4bb3 0x4b99 0x4b8e 0x4c17 0x4bfb 0x4bb3 0x4b99 0x4b8e 0x4c17 0x4bfb 0x4bb3 0x4b99 0x4b8e>;
					};

					qcom,pc-temp-z4-lut {
						qcom,lut-col-legend = <0x0 0xa 0x19 0x28 0x32>;
						qcom,lut-row-legend = <0x2710 0x2648 0x2580 0x24b8 0x23f0 0x2328 0x2260 0x2198 0x20d0 0x2008 0x1f40 0x1e78 0x1db0 0x1ce8 0x1c20 0x1b58 0x1a90 0x19c8 0x1900 0x1838 0x1770 0x16a8 0x15e0 0x1518 0x1450 0x1388 0x12c0 0x11f8 0x1130 0x1068 0xfa0 0xed8 0xe10 0xd48 0xc80 0xbb8 0xaf0 0xa28 0x960 0x898 0x7d0 0x708 0x640 0x578 0x4b0 0x3e8 0x384 0x320 0x2bc 0x258 0x1f4 0x190 0x12c 0xc8 0x64 0x0>;
						qcom,lut-data = <0x3de7 0x3c2e 0x3a96 0x39c0 0x39d8 0x3e4d 0x3bfb 0x3ac4 0x3a1e 0x39e9 0x3db2 0x3bb0 0x3a6f 0x39f6 0x39ce 0x3ca4 0x3b38 0x3a20 0x39be 0x3999 0x3be7 0x3ab0 0x39e5 0x39a3 0x3985 0x3b5f 0x3a54 0x39b8 0x398f 0x397d 0x3af4 0x3a0e 0x39a8 0x3984 0x3978 0x3a9f 0x39e2 0x39a0 0x397f 0x3974 0x3a5a 0x39cb 0x3999 0x397b 0x3970 0x3a2c 0x39bd 0x3990 0x3976 0x396c 0x3a0d 0x39b6 0x3988 0x3970 0x3968 0x39f7 0x39b3 0x3982 0x396b 0x3963 0x39e7 0x39b0 0x397c 0x3965 0x395f 0x39d9 0x399a 0x397a 0x3960 0x395a 0x39d5 0x397d 0x397a 0x395b 0x3955 0x39f5 0x397d 0x397a 0x3957 0x3950 0x3a1d 0x39ab 0x3979 0x3954 0x394d 0x3a1d 0x39ce 0x3973 0x3950 0x394a 0x39fd 0x39be 0x396c 0x394d 0x3947 0x39e3 0x399c 0x3963 0x394b 0x3944 0x39d9 0x399c 0x395c 0x3949 0x3941 0x39d2 0x3a01 0x397d 0x3954 0x3946 0x39e1 0x3a5c 0x39da 0x3990 0x3979 0x3a4e 0x3a5d 0x39fc 0x39b5 0x39a0 0x3aaa 0x3a54 0x39da 0x39a3 0x3992 0x3aa3 0x3a44 0x39b1 0x3985 0x3977 0x3a83 0x3a16 0x399f 0x3978 0x396b 0x3a65 0x39ea 0x3993 0x3972 0x3965 0x3a4a 0x39db 0x398d 0x396d 0x3960 0x3a32 0x39d3 0x398a 0x3968 0x395c 0x3a21 0x39d0 0x3988 0x3965 0x3959 0x3a13 0x39d0 0x3988 0x3963 0x3956 0x3a0b 0x39d0 0x3987 0x3961 0x3953 0x3a07 0x39d0 0x3988 0x3961 0x3952 0x3a05 0x39d1 0x398a 0x3961 0x3951 0x3a02 0x39d1 0x398c 0x3962 0x3950 0x39fd 0x39d0 0x398d 0x3966 0x3954 0x39fb 0x39cf 0x398e 0x396d 0x395f 0x39fe 0x39d0 0x398f 0x396f 0x3964 0x3a03 0x39d5 0x3990 0x396d 0x3963 0x3a04 0x39d7 0x3991 0x396b 0x3963 0x39fb 0x39cf 0x398d 0x3968 0x3963 0x39ef 0x39c2 0x3984 0x3964 0x3962 0x39e3 0x39b8 0x397f 0x3962 0x3962 0x39af 0x3994 0x396f 0x3956 0x3954 0x3994 0x3976 0x3958 0x393d 0x3935 0x398b 0x396f 0x394c 0x3937 0x392d 0x3985 0x3968 0x3940 0x392d 0x3923 0x3995 0x3964 0x393b 0x3928 0x391e 0x39f0 0x396b 0x3946 0x3931 0x3931 0x3993 0x3973 0x3945 0x3935 0x3936 0x399c 0x3971 0x3945 0x3938 0x3938 0x39a0 0x3970 0x3945 0x393a 0x3939 0x39c5 0x396b 0x3949 0x3937 0x3935 0x39c5 0x396b 0x3949 0x3937 0x3935 0x39c5 0x396b 0x3949 0x3937 0x3935>;
					};

					qcom,pc-temp-z5-lut {
						qcom,lut-col-legend = <0x0 0xa 0x19 0x28 0x32>;
						qcom,lut-row-legend = <0x2710 0x2648 0x2580 0x24b8 0x23f0 0x2328 0x2260 0x2198 0x20d0 0x2008 0x1f40 0x1e78 0x1db0 0x1ce8 0x1c20 0x1b58 0x1a90 0x19c8 0x1900 0x1838 0x1770 0x16a8 0x15e0 0x1518 0x1450 0x1388 0x12c0 0x11f8 0x1130 0x1068 0xfa0 0xed8 0xe10 0xd48 0xc80 0xbb8 0xaf0 0xa28 0x960 0x898 0x7d0 0x708 0x640 0x578 0x4b0 0x3e8 0x384 0x320 0x2bc 0x258 0x1f4 0x190 0x12c 0xc8 0x64 0x0>;
						qcom,lut-data = <0x2e10 0x2ff7 0x34df 0x3c36 0x377c 0x32c9 0x35f0 0x3b83 0x3fff 0x4408 0x3611 0x3afc 0x4048 0x4355 0x4a85 0x38b2 0x3ee8 0x447d 0x478b 0x5025 0x3b09 0x4284 0x4942 0x4b2c 0x52fd 0x3d49 0x4705 0x4cc2 0x4eb2 0x54ef 0x3ff7 0x4c89 0x4ce3 0x4fbc 0x559b 0x43c9 0x5110 0x4c13 0x4e60 0x5428 0x488a 0x5467 0x4bb9 0x4d0e 0x524d 0x4d02 0x5728 0x4d7d 0x4d79 0x527f 0x51ba 0x5860 0x4f90 0x4f03 0x5458 0x5496 0x5879 0x4f8e 0x50e0 0x5677 0x53f6 0x5908 0x4ede 0x53a1 0x5923 0x5251 0x5f48 0x4e9f 0x5671 0x5bb6 0x5219 0x688c 0x5068 0x58e5 0x5cd7 0x581b 0x693d 0x5266 0x5b5a 0x5cad 0x5f1d 0x5f87 0x52de 0x5cf9 0x5c67 0x5e98 0x5814 0x53bf 0x5ef9 0x5d46 0x5974 0x5945 0x5544 0x6017 0x5e93 0x5696 0x5d7a 0x5ad2 0x5f9a 0x5fe9 0x5a1b 0x64d5 0x6003 0x5e41 0x6180 0x6282 0x79a8 0x5e61 0x5b4b 0x6107 0x6c55 0x8a09 0x589a 0x5490 0x5a47 0x7b8c 0x7af6 0x54d4 0x50c2 0x54c9 0x8529 0x56e2 0x52be 0x51cd 0x53f5 0x7c79 0x4aaa 0x518f 0x5393 0x53a0 0x67a8 0x5194 0x542d 0x548b 0x5472 0x5db1 0x5af0 0x5bcf 0x5573 0x5876 0x5bcf 0x61e7 0x6186 0x56ef 0x5cea 0x5b44 0x6868 0x6507 0x5c11 0x6059 0x5d42 0x6c77 0x6803 0x62e4 0x63c1 0x62fb 0x6ef4 0x6ae6 0x67b5 0x67c5 0x67d4 0x708c 0x6d93 0x6bff 0x6c87 0x6aa3 0x7118 0x6fdd 0x6ed1 0x6f16 0x6cd3 0x7155 0x723c 0x70fa 0x6fbd 0x6ddf 0x7134 0x739c 0x7255 0x704d 0x6dd9 0x6fd8 0x72aa 0x7100 0x7150 0x6d83 0x6da7 0x6fc5 0x6d42 0x72d5 0x6d80 0x6b58 0x6c18 0x6bed 0x748e 0x6d78 0x686b 0x6622 0x6c1d 0x7831 0x6cf1 0x6550 0x6032 0x6c83 0x7b79 0x6b2c 0x6166 0x5b49 0x6f12 0x7c39 0x6931 0x5f44 0x57e3 0x72b8 0x7c8f 0x6735 0x5f82 0x5850 0x7108 0x7cc1 0x6d54 0x643f 0x5944 0x66fd 0x79d1 0x6b26 0x636d 0x55d4 0x5862 0x526b 0x67ba 0x6402 0x5750 0x5848 0x56c3 0x68b6 0x5d6a 0x5f29 0x58f7 0x5f82 0x5bb6 0x5c59 0x60a0 0x5abb 0x7108 0x4a02 0x5d61 0x56d4 0x712b 0x7414 0x5c09 0x54cb 0x5db6 0x6b3b 0x66df 0x4f6d 0x53e2 0x5c31 0x623e 0x602b 0x4a17 0x5204 0x5c36 0x5b47 0x59d5 0x419c 0x5270 0x5495 0x5faf 0x5ca4 0x419c 0x5270 0x5495 0x5faf 0x5ca4 0x419c 0x5270 0x5495 0x5faf 0x5ca4>;
					};

					qcom,pc-temp-z6-lut {
						qcom,lut-col-legend = <0x0 0xa 0x19 0x28 0x32>;
						qcom,lut-row-legend = <0x2710 0x2648 0x2580 0x24b8 0x23f0 0x2328 0x2260 0x2198 0x20d0 0x2008 0x1f40 0x1e78 0x1db0 0x1ce8 0x1c20 0x1b58 0x1a90 0x19c8 0x1900 0x1838 0x1770 0x16a8 0x15e0 0x1518 0x1450 0x1388 0x12c0 0x11f8 0x1130 0x1068 0xfa0 0xed8 0xe10 0xd48 0xc80 0xbb8 0xaf0 0xa28 0x960 0x898 0x7d0 0x708 0x640 0x578 0x4b0 0x3e8 0x384 0x320 0x2bc 0x258 0x1f4 0x190 0x12c 0xc8 0x64 0x0>;
						qcom,lut-data = <0x3da0 0x3ae9 0x38ee 0x3843 0x382a 0x3dce 0x3ada 0x3913 0x3879 0x384c 0x3d70 0x3ac2 0x38fb 0x386c 0x3844 0x3cc9 0x3a89 0x38e0 0x3859 0x3832 0x3c4a 0x3a35 0x38c3 0x384c 0x3828 0x3be4 0x39f8 0x38a8 0x3842 0x3823 0x3b92 0x39c6 0x389b 0x383a 0x381f 0x3b50 0x39a3 0x3892 0x3835 0x381a 0x3b1a 0x3990 0x388b 0x3830 0x3817 0x3af0 0x3983 0x3885 0x382c 0x3814 0x3ad1 0x397b 0x3880 0x3829 0x3811 0x3ab9 0x3976 0x387b 0x3826 0x380e 0x3aa6 0x3970 0x3876 0x3823 0x380c 0x3a95 0x3965 0x3873 0x3820 0x3809 0x3a8f 0x3958 0x3872 0x381e 0x3806 0x3a9a 0x3957 0x3871 0x381b 0x3802 0x3aa9 0x3963 0x3870 0x3819 0x37ff 0x3aa8 0x396d 0x386e 0x3817 0x37fd 0x3a97 0x3965 0x386b 0x3815 0x37fb 0x3a8b 0x3954 0x3866 0x3812 0x37f8 0x3a89 0x3954 0x3861 0x380e 0x37f6 0x3a89 0x3989 0x3873 0x3815 0x37f9 0x3a94 0x39b9 0x38a4 0x383a 0x381a 0x3ace 0x39b7 0x38b7 0x3851 0x3833 0x3afd 0x39af 0x38b0 0x384c 0x382f 0x3af9 0x39a7 0x38a7 0x3844 0x3826 0x3ae8 0x39a0 0x38a1 0x383e 0x3820 0x3adb 0x399a 0x389c 0x3839 0x381d 0x3ad1 0x3996 0x3898 0x3835 0x381a 0x3aca 0x3993 0x3894 0x3832 0x3816 0x3ac7 0x3991 0x3892 0x3830 0x3814 0x3ac5 0x398f 0x3890 0x382e 0x3811 0x3ac5 0x398e 0x388e 0x382b 0x380e 0x3ac6 0x398e 0x388e 0x382a 0x380b 0x3ac7 0x398f 0x388e 0x3828 0x3809 0x3ac9 0x3990 0x388f 0x3827 0x3807 0x3aca 0x3992 0x3890 0x3829 0x3809 0x3acc 0x3994 0x3891 0x382d 0x3812 0x3acf 0x3997 0x3892 0x3830 0x3816 0x3ad5 0x399b 0x3894 0x3830 0x3816 0x3ad9 0x399d 0x3895 0x3831 0x3817 0x3ada 0x399b 0x3892 0x3831 0x3817 0x3adb 0x399a 0x388e 0x3831 0x3818 0x3adb 0x3999 0x388e 0x3831 0x3819 0x3ac7 0x398c 0x3889 0x382a 0x3814 0x3abb 0x397c 0x3879 0x381a 0x37fd 0x3ab6 0x3978 0x3873 0x3814 0x37f7 0x3ab3 0x3972 0x386d 0x380c 0x37f0 0x3aac 0x3970 0x386a 0x3808 0x37ee 0x3aaf 0x397a 0x3872 0x3818 0x3800 0x3ac6 0x3984 0x387b 0x381e 0x3805 0x3acf 0x398a 0x387e 0x3820 0x3808 0x3adc 0x3993 0x3883 0x3823 0x380b 0x3af0 0x399f 0x3888 0x3828 0x380f 0x3af0 0x399f 0x3888 0x3828 0x380f 0x3af0 0x399f 0x3888 0x3828 0x380f>;
					};

					qcom,pc-temp-y1-lut {
						qcom,lut-col-legend = <0xfffffff6 0x0 0xa 0x19 0x28 0x32>;
						qcom,lut-row-legend = <0x2710 0x2648 0x2580 0x24b8 0x23f0 0x2328 0x2260 0x2198 0x20d0 0x2008 0x1f40 0x1e78 0x1db0 0x1ce8 0x1c20 0x1b58 0x1a90 0x19c8 0x1900 0x1838 0x1770 0x16a8 0x15e0 0x1518 0x1450 0x1388 0x12c0 0x11f8 0x1130 0x1068 0xfa0 0xed8 0xe10 0xd48 0xc80 0xbb8 0xaf0 0xa28 0x960 0x898 0x7d0 0x708 0x640 0x578 0x4b0 0x3e8 0x384 0x320 0x2bc 0x258 0x1f4 0x190 0x12c 0xc8 0x64 0x0>;
						qcom,lut-data = <0x16bd 0x14e3 0x13ad 0x1242 0x1181 0x114b 0x16d3 0x14e7 0x13ac 0x1240 0x1184 0x114d 0x16e9 0x14eb 0x13ab 0x123e 0x1185 0x114e 0x16fb 0x14f1 0x13a9 0x123b 0x1185 0x114e 0x1709 0x14f5 0x13a7 0x1238 0x1184 0x114f 0x170f 0x14f7 0x13a6 0x1234 0x1182 0x114f 0x170c 0x14f7 0x13a1 0x1230 0x117d 0x114e 0x1707 0x14f5 0x139b 0x122a 0x1179 0x114d 0x1708 0x14f4 0x1396 0x1226 0x1178 0x114b 0x170d 0x14ef 0x1392 0x1223 0x1178 0x1149 0x170f 0x14ec 0x1390 0x1220 0x1178 0x1147 0x1710 0x14ee 0x1393 0x121d 0x1176 0x1146 0x1714 0x14f1 0x1397 0x121a 0x1174 0x1146 0x1717 0x14f1 0x1395 0x1218 0x1173 0x1145 0x1720 0x14ef 0x138c 0x1216 0x1171 0x1143 0x1725 0x14ee 0x1388 0x1215 0x1170 0x1143 0x1722 0x14f5 0x138b 0x1215 0x1170 0x1143 0x171d 0x14fe 0x138f 0x1215 0x1170 0x1143 0x171d 0x1500 0x1390 0x1215 0x1170 0x1143 0x171c 0x14fd 0x138d 0x1216 0x1171 0x1143 0x171a 0x14fc 0x138b 0x1217 0x1171 0x1143 0x171a 0x1501 0x138c 0x1219 0x1173 0x1144 0x171c 0x1506 0x138d 0x121b 0x1175 0x1146 0x171d 0x1507 0x138d 0x121e 0x1175 0x1146 0x171d 0x1506 0x138e 0x1220 0x1175 0x1146 0x171d 0x1506 0x1390 0x1223 0x1176 0x1147 0x171b 0x150e 0x1395 0x1226 0x1178 0x1147 0x1717 0x1518 0x139b 0x122a 0x117a 0x1148 0x1713 0x1519 0x13a0 0x122e 0x117c 0x114a 0x170c 0x1516 0x13a5 0x1233 0x117f 0x114c 0x1708 0x1513 0x13a8 0x1238 0x1181 0x114e 0x1712 0x1513 0x13a8 0x123d 0x1184 0x114f 0x1722 0x1516 0x13a8 0x1243 0x1187 0x1150 0x172c 0x1519 0x13ab 0x1247 0x118a 0x1152 0x1737 0x151b 0x13b3 0x124a 0x118d 0x1155 0x173a 0x151d 0x13b7 0x124e 0x1190 0x1158 0x172d 0x1519 0x13b7 0x1253 0x1193 0x115a 0x1718 0x1513 0x13b8 0x1257 0x1195 0x115c 0x170d 0x1511 0x13bd 0x125d 0x1198 0x115d 0x1704 0x1511 0x13c5 0x1263 0x119a 0x115e 0x16ff 0x1511 0x13c9 0x1266 0x119d 0x1160 0x1708 0x1512 0x13c8 0x1269 0x119f 0x1163 0x170c 0x1516 0x13ca 0x126b 0x11a1 0x1163 0x16fb 0x152a 0x13d7 0x126d 0x11a3 0x1163 0x171b 0x1522 0x13d3 0x1275 0x11a6 0x1166 0x1712 0x1517 0x13e1 0x1276 0x11a9 0x1168 0x170b 0x151a 0x13e0 0x1277 0x11a7 0x1169 0x1705 0x1518 0x13d9 0x127e 0x11aa 0x1169 0x1706 0x1528 0x13da 0x1281 0x11a9 0x1169 0x1705 0x152e 0x13e1 0x127f 0x11ab 0x116a 0x173f 0x151b 0x13eb 0x1282 0x11ad 0x116c 0x175a 0x1523 0x13ec 0x1290 0x11b1 0x116e 0x1737 0x151e 0x13f3 0x128c 0x11b6 0x1170 0x1743 0x152c 0x13f4 0x1295 0x11b8 0x1175 0x1743 0x152c 0x13f4 0x1295 0x11b8 0x1175 0x1743 0x152c 0x13f4 0x1295 0x11b8 0x1175>;
					};

					qcom,pc-temp-y2-lut {
						qcom,lut-col-legend = <0xfffffff6 0x0 0xa 0x19 0x28 0x32>;
						qcom,lut-row-legend = <0x2710 0x2648 0x2580 0x24b8 0x23f0 0x2328 0x2260 0x2198 0x20d0 0x2008 0x1f40 0x1e78 0x1db0 0x1ce8 0x1c20 0x1b58 0x1a90 0x19c8 0x1900 0x1838 0x1770 0x16a8 0x15e0 0x1518 0x1450 0x1388 0x12c0 0x11f8 0x1130 0x1068 0xfa0 0xed8 0xe10 0xd48 0xc80 0xbb8 0xaf0 0xa28 0x960 0x898 0x7d0 0x708 0x640 0x578 0x4b0 0x3e8 0x384 0x320 0x2bc 0x258 0x1f4 0x190 0x12c 0xc8 0x64 0x0>;
						qcom,lut-data = <0x276b 0x2807 0x290d 0x2a0f 0x2a21 0x2aaf 0x2765 0x2813 0x2904 0x29f4 0x2a37 0x2ace 0x2762 0x2822 0x28f9 0x29d7 0x2a42 0x2ade 0x2762 0x2830 0x28ef 0x29bc 0x2a45 0x2ae2 0x2764 0x283d 0x28e6 0x29a5 0x2a42 0x2ade 0x2768 0x2845 0x28df 0x2993 0x2a3d 0x2ad7 0x2791 0x284a 0x28da 0x2986 0x2a23 0x2ac4 0x27d4 0x284e 0x28d6 0x297b 0x2a02 0x2aa8 0x2802 0x284d 0x28d4 0x296e 0x29fc 0x2a8b 0x2845 0x2846 0x28d0 0x295d 0x29fd 0x2a66 0x2867 0x2842 0x28ce 0x2952 0x29fe 0x2a51 0x286c 0x286d 0x28d3 0x2955 0x29f8 0x2a52 0x2879 0x28c1 0x28de 0x295c 0x29ef 0x2a55 0x2872 0x2914 0x28f2 0x295c 0x29ee 0x2a51 0x281b 0x2979 0x291d 0x2959 0x29ed 0x2a46 0x27d4 0x29af 0x2951 0x295f 0x29ed 0x2a40 0x2709 0x29b5 0x2996 0x297e 0x29ed 0x2a48 0x25fc 0x29b7 0x29d5 0x29ae 0x29ee 0x2a55 0x25cd 0x29ba 0x29ec 0x29f5 0x29ec 0x2a5f 0x25c7 0x29c1 0x29f9 0x2a59 0x29e9 0x2a69 0x25c4 0x29c4 0x29fe 0x2a7d 0x29f0 0x2a79 0x25c2 0x29c7 0x29fb 0x2a4c 0x2a51 0x2aa2 0x25c0 0x29cd 0x29f7 0x2a17 0x2abc 0x2ad5 0x25bf 0x29ca 0x2a02 0x2a20 0x2acc 0x2af7 0x25bd 0x29b4 0x2a19 0x2a48 0x2ad0 0x2b16 0x25bc 0x2990 0x2a28 0x2a69 0x2ad5 0x2b2e 0x25bb 0x2937 0x2a2e 0x2a80 0x2adc 0x2b46 0x25ba 0x28b0 0x2a35 0x2a94 0x2ae4 0x2b5e 0x25b9 0x282f 0x2a44 0x2aa4 0x2af2 0x2b71 0x25b8 0x2796 0x2a5f 0x2ab2 0x2b0d 0x2b81 0x25b8 0x271a 0x2a6a 0x2ac4 0x2b28 0x2b94 0x25b7 0x26b9 0x2a5c 0x2aed 0x2b45 0x2bb1 0x25b7 0x2669 0x2a48 0x2b0e 0x2b61 0x2bca 0x25b6 0x263f 0x2a37 0x2b0d 0x2b81 0x2bd4 0x25b6 0x2621 0x2a22 0x2b03 0x2ba2 0x2bda 0x25b6 0x2609 0x2a10 0x2afd 0x2ba9 0x2bdc 0x25b6 0x25f4 0x2a01 0x2b03 0x2b83 0x2bc0 0x25b6 0x25e3 0x29f1 0x2b09 0x2b5e 0x2ba2 0x25b5 0x25d9 0x29d8 0x2b04 0x2b58 0x2b99 0x25b5 0x25d1 0x29b3 0x2af4 0x2b55 0x2b88 0x25b5 0x25cb 0x2978 0x2ae4 0x2b49 0x2b6e 0x25b5 0x25c7 0x28fb 0x2ad1 0x2b18 0x2b3a 0x25b5 0x25c3 0x2889 0x2ab8 0x2b01 0x2b30 0x25b5 0x25c0 0x282c 0x2a96 0x2afa 0x2b58 0x25b5 0x25bd 0x27dd 0x2a73 0x2af8 0x2af5 0x25b4 0x25bb 0x27cd 0x2a44 0x2ab7 0x2abd 0x25b4 0x25bb 0x27ba 0x2a5a 0x2a80 0x2a9b 0x25b4 0x25ba 0x281a 0x2a22 0x2a9b 0x2a92 0x25b4 0x25b9 0x2866 0x2a43 0x2aae 0x2a9c 0x25b4 0x25b8 0x280a 0x2a47 0x2a7b 0x2a63 0x25b4 0x25b7 0x2735 0x29fe 0x2a4d 0x2a32 0x25b4 0x25b6 0x26f4 0x299b 0x29fe 0x2a0e 0x25b3 0x25b5 0x26a3 0x29ef 0x29c2 0x29b3 0x25b2 0x25b5 0x27bb 0x29b7 0x2949 0x2930 0x25b2 0x25b5 0x27bb 0x29b7 0x2949 0x2930 0x25b2 0x25b5 0x27bb 0x29b7 0x2949 0x2930>;
					};

					qcom,pc-temp-y3-lut {
						qcom,lut-col-legend = <0xfffffff6 0x0 0xa 0x19 0x28 0x32>;
						qcom,lut-row-legend = <0x2710 0x2648 0x2580 0x24b8 0x23f0 0x2328 0x2260 0x2198 0x20d0 0x2008 0x1f40 0x1e78 0x1db0 0x1ce8 0x1c20 0x1b58 0x1a90 0x19c8 0x1900 0x1838 0x1770 0x16a8 0x15e0 0x1518 0x1450 0x1388 0x12c0 0x11f8 0x1130 0x1068 0xfa0 0xed8 0xe10 0xd48 0xc80 0xbb8 0xaf0 0xa28 0x960 0x898 0x7d0 0x708 0x640 0x578 0x4b0 0x3e8 0x384 0x320 0x2bc 0x258 0x1f4 0x190 0x12c 0xc8 0x64 0x0>;
						qcom,lut-data = <0x36c4 0x34ad 0x3424 0x33ea 0x33dc 0x33d5 0x3658 0x34ac 0x3426 0x33ea 0x33dc 0x33d6 0x3617 0x34aa 0x3427 0x33ea 0x33dd 0x33d7 0x35f6 0x34a9 0x3428 0x33ea 0x33dd 0x33d8 0x35ea 0x34a7 0x3429 0x33ea 0x33de 0x33da 0x35e8 0x34a5 0x3429 0x33ea 0x33de 0x33da 0x3616 0x34a2 0x3429 0x33ea 0x33de 0x33db 0x365b 0x349f 0x3429 0x33e9 0x33df 0x33db 0x3639 0x34a0 0x3429 0x33ea 0x33df 0x33db 0x354e 0x34a5 0x3428 0x33eb 0x33df 0x33db 0x34bb 0x34a8 0x3427 0x33ec 0x33e0 0x33db 0x34df 0x349e 0x3427 0x33ee 0x33e0 0x33dc 0x3518 0x348e 0x3427 0x33f0 0x33e0 0x33dd 0x3525 0x3489 0x3428 0x33f1 0x33e1 0x33dd 0x3515 0x3482 0x342c 0x33f1 0x33e2 0x33dd 0x3506 0x347c 0x342e 0x33f2 0x33e2 0x33dd 0x34e8 0x347a 0x3428 0x33f2 0x33e2 0x33dd 0x34c3 0x3475 0x341f 0x33f4 0x33e3 0x33dd 0x34bf 0x346d 0x341d 0x33f5 0x33e4 0x33de 0x34c6 0x345b 0x341c 0x33f6 0x33e5 0x33e0 0x34cd 0x3449 0x341a 0x33f7 0x33e6 0x33e1 0x34d1 0x343c 0x3413 0x33f2 0x33e2 0x33de 0x34d3 0x3431 0x340b 0x33eb 0x33de 0x33db 0x34d3 0x3428 0x3407 0x33e8 0x33dd 0x33da 0x34dd 0x3421 0x3404 0x33e6 0x33dd 0x33d9 0x34f1 0x341a 0x3402 0x33e5 0x33dc 0x33d8 0x3519 0x3408 0x33ff 0x33e5 0x33dd 0x33d9 0x354e 0x33f3 0x33fd 0x33e5 0x33dd 0x33d9 0x3580 0x33e8 0x33fc 0x33e5 0x33dc 0x33d9 0x35b6 0x33d7 0x33fb 0x33e6 0x33dc 0x33d9 0x35ee 0x33d2 0x33f9 0x33e6 0x33db 0x33d9 0x362a 0x33d4 0x33f7 0x33e5 0x33db 0x33d9 0x3669 0x33d7 0x33f5 0x33e5 0x33db 0x33d8 0x36aa 0x33da 0x33f5 0x33e5 0x33db 0x33d8 0x36ec 0x33de 0x33f7 0x33e4 0x33dc 0x33d8 0x3736 0x33e4 0x33f9 0x33e4 0x33dd 0x33d8 0x378c 0x33ef 0x33fb 0x33e3 0x33dc 0x33d9 0x37e8 0x33ff 0x33fd 0x33e2 0x33db 0x33d9 0x3845 0x3414 0x33ff 0x33e2 0x33db 0x33d9 0x38a5 0x3432 0x3400 0x33e2 0x33dc 0x33da 0x3904 0x3451 0x3401 0x33e2 0x33dc 0x33da 0x395f 0x3468 0x3401 0x33e2 0x33dd 0x33da 0x39bd 0x3483 0x3402 0x33e3 0x33dd 0x33da 0x3a24 0x34b0 0x3405 0x33e4 0x33dc 0x33d9 0x3a96 0x34fd 0x340a 0x33e5 0x33dc 0x33da 0x3a8c 0x351c 0x340e 0x33e8 0x33de 0x33dc 0x3ad3 0x3551 0x3412 0x33e9 0x33df 0x33dd 0x3b30 0x3590 0x341b 0x33ee 0x33e3 0x33df 0x3b8f 0x35d8 0x3427 0x33f0 0x33e2 0x33dd 0x3bec 0x3617 0x3428 0x33ef 0x33e0 0x33dc 0x3c53 0x3662 0x342b 0x33ef 0x33e1 0x33dd 0x3d0b 0x36ec 0x3437 0x33f2 0x33e4 0x33df 0x3df9 0x37b2 0x3448 0x33f8 0x33e6 0x33e3 0x4115 0x38c2 0x3473 0x3400 0x33eb 0x33e7 0x4115 0x38c2 0x3473 0x3400 0x33eb 0x33e7 0x4115 0x38c2 0x3473 0x3400 0x33eb 0x33e7>;
					};

					qcom,pc-temp-y4-lut {
						qcom,lut-col-legend = <0xfffffff6 0x0 0xa 0x19 0x28 0x32>;
						qcom,lut-row-legend = <0x2710 0x2648 0x2580 0x24b8 0x23f0 0x2328 0x2260 0x2198 0x20d0 0x2008 0x1f40 0x1e78 0x1db0 0x1ce8 0x1c20 0x1b58 0x1a90 0x19c8 0x1900 0x1838 0x1770 0x16a8 0x15e0 0x1518 0x1450 0x1388 0x12c0 0x11f8 0x1130 0x1068 0xfa0 0xed8 0xe10 0xd48 0xc80 0xbb8 0xaf0 0xa28 0x960 0x898 0x7d0 0x708 0x640 0x578 0x4b0 0x3e8 0x384 0x320 0x2bc 0x258 0x1f4 0x190 0x12c 0xc8 0x64 0x0>;
						qcom,lut-data = <0x4658 0x4267 0x414e 0x4074 0x404c 0x4048 0x4698 0x42a9 0x414f 0x4071 0x404b 0x4046 0x46bf 0x42d5 0x414d 0x406d 0x4049 0x4044 0x46d3 0x42ef 0x414a 0x4069 0x4047 0x4043 0x46da 0x42fc 0x4145 0x4066 0x4045 0x4041 0x46db 0x4300 0x413f 0x4065 0x4045 0x4040 0x466d 0x42f1 0x4135 0x4066 0x4044 0x4040 0x45c7 0x42d8 0x412b 0x4066 0x4044 0x403f 0x45e8 0x42c9 0x4129 0x4068 0x4044 0x4040 0x473b 0x42bb 0x4128 0x406a 0x4046 0x4041 0x484c 0x42b5 0x4128 0x406c 0x4047 0x4042 0x48bb 0x42d7 0x412b 0x4070 0x4049 0x4043 0x490c 0x431c 0x4131 0x4075 0x404d 0x4044 0x48af 0x436c 0x4148 0x407d 0x4052 0x4045 0x46bb 0x43e8 0x4192 0x408a 0x4059 0x4049 0x4566 0x4426 0x41ce 0x409a 0x4061 0x404e 0x4536 0x43e3 0x41f3 0x40aa 0x4067 0x4054 0x4517 0x436b 0x420c 0x40be 0x4070 0x405b 0x44dd 0x4316 0x4209 0x40e5 0x4084 0x406a 0x447e 0x42d4 0x41f0 0x4123 0x40aa 0x4084 0x43ff 0x4292 0x41c9 0x4139 0x40b8 0x408e 0x4307 0x4243 0x416a 0x40f4 0x4097 0x4079 0x41fb 0x41f9 0x4104 0x409e 0x406c 0x405c 0x41a6 0x41cd 0x40df 0x407b 0x4059 0x404f 0x4182 0x41b2 0x40cb 0x4064 0x404d 0x4046 0x4173 0x4192 0x40c4 0x405e 0x4049 0x4044 0x4171 0x4157 0x40c2 0x405f 0x4049 0x4044 0x4171 0x4121 0x40c2 0x4060 0x4049 0x4044 0x4174 0x411d 0x40c3 0x4063 0x404b 0x4045 0x417b 0x412d 0x40c5 0x406a 0x404e 0x4047 0x4183 0x4139 0x40c5 0x4071 0x4053 0x404a 0x418f 0x4141 0x40ae 0x407a 0x4059 0x4050 0x419d 0x414d 0x4097 0x4080 0x4061 0x4056 0x41ad 0x415c 0x409a 0x4083 0x4068 0x405b 0x41bf 0x4171 0x40a8 0x4085 0x406f 0x405f 0x41ce 0x4181 0x40b8 0x4083 0x406f 0x405f 0x41da 0x418d 0x40cb 0x406d 0x405a 0x4051 0x41e5 0x4197 0x40d9 0x4059 0x4046 0x4043 0x41ed 0x419a 0x40d8 0x4056 0x4042 0x4043 0x41f3 0x4198 0x40d7 0x4054 0x4041 0x4044 0x41f5 0x4194 0x40d7 0x4055 0x4040 0x4044 0x41ec 0x4182 0x40e0 0x405a 0x4041 0x4043 0x41e1 0x4175 0x40ea 0x405f 0x4040 0x4040 0x41dc 0x4175 0x40f4 0x4061 0x403a 0x4033 0x41ef 0x4179 0x4105 0x4064 0x403c 0x4033 0x41fb 0x4195 0x410c 0x4072 0x4047 0x4045 0x422f 0x41bb 0x412a 0x407f 0x405b 0x4071 0x4276 0x41f1 0x415d 0x4099 0x4098 0x40b2 0x42b9 0x4250 0x41a2 0x40ce 0x40ad 0x4092 0x42c1 0x427c 0x41a0 0x40b3 0x405e 0x4053 0x4297 0x425f 0x41a1 0x40aa 0x405d 0x4055 0x4292 0x426e 0x41c2 0x40c8 0x4074 0x4068 0x42d1 0x42ba 0x4207 0x4109 0x40a9 0x40a0 0x4493 0x4351 0x42cc 0x41bc 0x417f 0x414e 0x4493 0x4351 0x42cc 0x41bc 0x417f 0x414e 0x4493 0x4351 0x42cc 0x41bc 0x417f 0x414e>;
					};

					qcom,pc-temp-y5-lut {
						qcom,lut-col-legend = <0xfffffff6 0x0 0xa 0x19 0x28 0x32>;
						qcom,lut-row-legend = <0x2710 0x2648 0x2580 0x24b8 0x23f0 0x2328 0x2260 0x2198 0x20d0 0x2008 0x1f40 0x1e78 0x1db0 0x1ce8 0x1c20 0x1b58 0x1a90 0x19c8 0x1900 0x1838 0x1770 0x16a8 0x15e0 0x1518 0x1450 0x1388 0x12c0 0x11f8 0x1130 0x1068 0xfa0 0xed8 0xe10 0xd48 0xc80 0xbb8 0xaf0 0xa28 0x960 0x898 0x7d0 0x708 0x640 0x578 0x4b0 0x3e8 0x384 0x320 0x2bc 0x258 0x1f4 0x190 0x12c 0xc8 0x64 0x0>;
						qcom,lut-data = <0x2dcf 0x2ea6 0x34c2 0x3f88 0x444d 0x35af 0x2bb3 0x2f95 0x360a 0x3fb0 0x4531 0x3c53 0x2ac4 0x3098 0x374a 0x3f1a 0x4617 0x4249 0x2ac2 0x3191 0x3867 0x3e11 0x46de 0x473e 0x2b6f 0x3261 0x3945 0x3cdc 0x4765 0x4adc 0x2c8b 0x32eb 0x39c8 0x3bc4 0x478b 0x4ccd 0x30b1 0x332c 0x3a07 0x3a3f 0x4749 0x4d1b 0x35fe 0x335e 0x3a10 0x38b6 0x46c1 0x4c61 0x3566 0x33f5 0x399a 0x383b 0x45cb 0x4aa2 0x2daf 0x3592 0x3854 0x3805 0x43d1 0x4729 0x28de 0x3686 0x3710 0x37f6 0x41d5 0x44e7 0x2ced 0x333a 0x3627 0x38aa 0x4016 0x44bc 0x33a3 0x2e59 0x3538 0x3982 0x3e49 0x44cb 0x363c 0x2e2f 0x33de 0x38a2 0x3c4b 0x438f 0x3618 0x31e6 0x31fd 0x357d 0x39f2 0x4097 0x357b 0x35b4 0x312d 0x33fd 0x3886 0x3de5 0x336f 0x38da 0x31cf 0x3416 0x37bf 0x3b27 0x312a 0x3b5b 0x3333 0x344e 0x373e 0x38ee 0x32dc 0x3b9a 0x364c 0x34fc 0x3748 0x38a8 0x384d 0x3ab3 0x3ca3 0x36f4 0x37ae 0x3927 0x3caf 0x3a21 0x3fd6 0x3983 0x386e 0x3a1c 0x3cd7 0x3a4b 0x403c 0x3e29 0x3b30 0x3dab 0x3ad5 0x3aa6 0x405e 0x420f 0x3f25 0x4203 0x3803 0x3b5d 0x4032 0x4223 0x4331 0x4443 0x302e 0x3d0b 0x3fd7 0x416a 0x479b 0x45ee 0x2c32 0x3e6a 0x3f8c 0x411b 0x4967 0x46bd 0x2c87 0x3c91 0x3ee4 0x40c5 0x4958 0x4704 0x2cf8 0x38b8 0x3e3e 0x4095 0x48b7 0x46f9 0x2d05 0x35a9 0x3e9c 0x415a 0x46ff 0x4685 0x2d1e 0x2f0d 0x3ffc 0x42ba 0x43bc 0x45c2 0x2d44 0x2c58 0x40b5 0x4323 0x4149 0x449d 0x2dc6 0x2cb5 0x3ffe 0x42a4 0x3f46 0x41ae 0x2e59 0x2d1e 0x3f20 0x4230 0x3e0b 0x3f37 0x2e84 0x2d75 0x3f46 0x4366 0x3ff7 0x3fc3 0x2ecc 0x2dd9 0x3fc7 0x4622 0x4519 0x4235 0x2f2b 0x2e2a 0x4027 0x46e8 0x4849 0x4567 0x3086 0x2e8b 0x406f 0x463e 0x4a2b 0x4b28 0x31fa 0x2f27 0x409c 0x4546 0x4b67 0x5113 0x322b 0x302e 0x403c 0x4411 0x4cd5 0x5545 0x320c 0x3218 0x3ef4 0x427c 0x4f28 0x58c3 0x31c4 0x331e 0x3d2f 0x410e 0x4fef 0x595f 0x3044 0x31c5 0x3a0e 0x3f2b 0x503d 0x57b1 0x2e6a 0x2fe8 0x3821 0x3ea2 0x5092 0x58b7 0x2d32 0x2ead 0x3748 0x3f17 0x521c 0x6103 0x2cdf 0x2eaf 0x36b6 0x3dc8 0x492e 0x50c2 0x2d8e 0x2e7f 0x3677 0x3e83 0x458d 0x4ed5 0x2d87 0x2f45 0x3572 0x3c42 0x42c6 0x44af 0x2e40 0x3090 0x35e9 0x3e8f 0x3fc4 0x3a9e 0x30bc 0x3294 0x374b 0x3c46 0x3a32 0x3902 0x31d0 0x335f 0x37f3 0x3f80 0x457f 0x4378 0x2f31 0x3311 0x37cd 0x41e5 0x44dd 0x44d9 0x2dd6 0x323a 0x3777 0x4143 0x4ade 0x45e1 0x2dfa 0x3117 0x3679 0x42f9 0x478d 0x47fd 0x2ec8 0x2fd4 0x3b77 0x423f 0x4578 0x43d7 0x2ec8 0x2fd4 0x3b77 0x423f 0x4578 0x43d7 0x2ec8 0x2fd4 0x3b77 0x423f 0x4578 0x43d7>;
					};

					qcom,pc-temp-y6-lut {
						qcom,lut-col-legend = <0xfffffff6 0x0 0xa 0x19 0x28 0x32>;
						qcom,lut-row-legend = <0x2710 0x2648 0x2580 0x24b8 0x23f0 0x2328 0x2260 0x2198 0x20d0 0x2008 0x1f40 0x1e78 0x1db0 0x1ce8 0x1c20 0x1b58 0x1a90 0x19c8 0x1900 0x1838 0x1770 0x16a8 0x15e0 0x1518 0x1450 0x1388 0x12c0 0x11f8 0x1130 0x1068 0xfa0 0xed8 0xe10 0xd48 0xc80 0xbb8 0xaf0 0xa28 0x960 0x898 0x7d0 0x708 0x640 0x578 0x4b0 0x3e8 0x384 0x320 0x2bc 0x258 0x1f4 0x190 0x12c 0xc8 0x64 0x0>;
						qcom,lut-data = <0x1997 0x15e0 0x1464 0x137e 0x134f 0x1342 0x1986 0x15e5 0x1460 0x137c 0x134e 0x1343 0x196f 0x15e5 0x145b 0x137a 0x134e 0x1343 0x1958 0x15e1 0x1455 0x1378 0x134e 0x1343 0x1946 0x15da 0x144f 0x1377 0x134e 0x1344 0x193d 0x15d0 0x1449 0x1376 0x134e 0x1344 0x193c 0x15c2 0x1442 0x1375 0x134e 0x1344 0x193d 0x15b2 0x143b 0x1374 0x134e 0x1344 0x1932 0x15a9 0x1436 0x1375 0x134e 0x1344 0x1903 0x15a2 0x1431 0x1375 0x134e 0x1345 0x18e7 0x159f 0x142e 0x1376 0x134f 0x1345 0x1921 0x15a0 0x142d 0x1378 0x134f 0x1345 0x1975 0x15a3 0x142c 0x137b 0x1351 0x1346 0x1968 0x15ac 0x1431 0x137d 0x1352 0x1347 0x18da 0x15c9 0x1447 0x1381 0x1355 0x1348 0x1872 0x15d9 0x1456 0x1386 0x1357 0x134a 0x1857 0x15c8 0x145a 0x138b 0x135a 0x134b 0x1844 0x15a7 0x145c 0x1391 0x135c 0x134e 0x1841 0x158a 0x145b 0x139d 0x1362 0x1352 0x183d 0x156e 0x1453 0x13b0 0x136e 0x135b 0x1837 0x1553 0x1446 0x13b6 0x1372 0x135e 0x180c 0x1537 0x1427 0x139f 0x1366 0x1356 0x17d5 0x151f 0x1405 0x1382 0x1357 0x134b 0x17d0 0x1515 0x13f9 0x1376 0x1351 0x1346 0x17e7 0x1511 0x13f3 0x136e 0x134d 0x1343 0x1802 0x150b 0x13f1 0x136c 0x134c 0x1342 0x182a 0x14fd 0x13f1 0x136d 0x134c 0x1342 0x185d 0x14ef 0x13f2 0x136e 0x134c 0x1343 0x188d 0x14ef 0x13f4 0x136f 0x134c 0x1343 0x18bf 0x14fe 0x13f8 0x1372 0x134d 0x1344 0x18f2 0x1512 0x13f9 0x1375 0x134e 0x1345 0x1926 0x152a 0x13f5 0x1378 0x1350 0x1346 0x195b 0x1548 0x13f2 0x137a 0x1352 0x1348 0x1992 0x1566 0x13f5 0x137c 0x1355 0x134a 0x19cb 0x1588 0x1400 0x137d 0x1358 0x134b 0x1a09 0x15ab 0x140d 0x137d 0x1358 0x134b 0x1a4c 0x15cf 0x1419 0x1377 0x1352 0x1348 0x1a93 0x15f5 0x1426 0x1372 0x134c 0x1344 0x1adc 0x161e 0x142f 0x1372 0x134c 0x1344 0x1b26 0x164c 0x1438 0x1372 0x134c 0x1345 0x1b6e 0x167a 0x1442 0x1373 0x134c 0x1345 0x1bb1 0x16a7 0x1451 0x1376 0x134e 0x1346 0x1bf5 0x16da 0x1463 0x1379 0x134e 0x1345 0x1c43 0x171b 0x1478 0x137b 0x134b 0x1341 0x1ca2 0x1773 0x1498 0x137f 0x134d 0x1342 0x1c9e 0x179d 0x149f 0x1386 0x1352 0x1349 0x1ce3 0x17d8 0x14b8 0x138b 0x1358 0x1356 0x1d3b 0x181d 0x14dd 0x1396 0x136d 0x136a 0x1d99 0x1875 0x1509 0x13a8 0x1372 0x1360 0x1de8 0x18bb 0x1515 0x13a0 0x135a 0x134d 0x1e2f 0x18f8 0x1529 0x139f 0x135b 0x134f 0x1ec1 0x1975 0x155c 0x13ab 0x1365 0x1356 0x1f8e 0x1a2e 0x15a3 0x13c4 0x1376 0x136a 0x2295 0x1b2a 0x1631 0x1400 0x13b7 0x139f 0x2295 0x1b2a 0x1631 0x1400 0x13b7 0x139f 0x2295 0x1b2a 0x1631 0x1400 0x13b7 0x139f>;
					};
				};
			};
		};
	};

	fragment@19 {
		target = <0xffffffff>;

		__overlay__ {

			smb_int_default {
				phandle = <0x1d>;

				mux {
					pins = "gpio105";
					function = "gpio";
				};

				config {
					pins = "gpio105";
					bias-pull-up;
					input-enable;
				};
			};
		};
	};

	fragment@20 {
		target = <0xffffffff>;

		__overlay__ {
			status = "ok";

			qcom,smb1394@34 {
				compatible = "qcom,i2c-pmic";
				reg = <0x34>;
				#address-cells = <0x1>;
				#size-cells = <0x0>;
				interrupt-controller;
				#interrupt-cells = <0x3>;
				qcom,periph-map = <0x6 0x26 0x27>;
				status = "ok";
				pinctrl-names = "default";
				pinctrl-0 = <0x1d>;
				interrupt-parent = <0xffffffff>;
				interrupt-names = "smb1394";
				interrupts = <0x69 0x8>;
				phandle = <0x2f>;

				qcom,div2_cp_pry {
					compatible = "qcom,smb1394-div2-cp-primary";
					#io-channel-cells = <0x1>;
					interrupts = <0x26 0x1 0x1 0x26 0x3 0x1 0x26 0x5 0x1 0x26 0x7 0x1 0x27 0x5 0x1 0x27 0x6 0x1 0x27 0x7 0x1>;
					interrupt-names = "temp-shdwn", "div2-irev", "usbin-uv", "usbin-ov", "div2-ilim", "div2-win-uv", "div2-win-ov";
					qcom,div2-cp-min-ilim-ua = <0xf4240>;
					status = "ok";
					io-channels = <0xd 0xe>;
					io-channel-names = "die_temp";
					qcom,parallel-input-mode = <0x1>;
					qcom,parallel-output-mode = <0x2>;
					phandle = <0x30>;
				};
			};
		};
	};

	fragment@21 {
		target = <0xffffffff>;

		__overlay__ {
			extcon = <0x1e 0x12 0xffffffff>;
		};
	};

	fragment@22 {
		target = <0xffffffff>;

		__overlay__ {

			quiet-therm {

				cooling-maps {

					quiet_batt_cdev1 {
						trip = <0x1f>;
						cooling-device = <0x12 0x8 0x8>;
					};

					quiet_batt_cdev2 {
						trip = <0x20>;
						cooling-device = <0x12 0xc 0xc>;
					};

					quiet_batt_cdev3 {
						trip = <0x21>;
						cooling-device = <0x12 0xe 0xe>;
					};

					quiet_batt_cdev4 {
						trip = <0x22>;
						cooling-device = <0x12 0x10 0x10>;
					};
				};
			};

			pm7250b-tz {

				cooling-maps {

					trip0_bat {
						cooling-device = <0x12 0xf 0xf>;
					};

					trip1_bat {
						cooling-device = <0x12 0x10 0x10>;
					};
				};
			};
		};
	};

	__symbols__ {
		key_vol_up_default = "/fragment@1/__overlay__/key_vol_up/key_vol_up_default";
		usb_eldo9 = "/fragment@1/__overlay__/eldo9_pin/gpio@c000";
		vdda_usb_ss_dp_core = "/fragment@2/__overlay__/vdda_usb_ss_dp_core";
		quiet_batt_trip0 = "/fragment@11/__overlay__/quiet-therm/trips/batt-trip0";
		quiet_modem_trip0 = "/fragment@11/__overlay__/quiet-therm/trips/modem-trip0";
		quiet_batt_trip1 = "/fragment@11/__overlay__/quiet-therm/trips/batt-trip1";
		quiet_batt_trip2 = "/fragment@11/__overlay__/quiet-therm/trips/batt-trip2";
		quiet_gold_trip = "/fragment@11/__overlay__/quiet-therm/trips/gold-trip";
		quiet_batt_trip3 = "/fragment@11/__overlay__/quiet-therm/trips/batt-trip3";
		quiet_batt_trip4 = "/fragment@11/__overlay__/quiet-therm/trips/batt-trip4";
		quiet_gpu_trip = "/fragment@11/__overlay__/quiet-therm/trips/gpu-trip";
		quiet_silver_trip = "/fragment@11/__overlay__/quiet-therm/trips/silver-trip";
		quiet_hvx_trip = "/fragment@11/__overlay__/quiet-therm/trips/hvx-trip";
		quiet_modem_trip1 = "/fragment@11/__overlay__/quiet-therm/trips/modem-trip1";
		pa_therm0_trip0 = "/fragment@11/__overlay__/pa-therm0/trips/pa-therm0-trip0";
		pa_therm0_trip1 = "/fragment@11/__overlay__/pa-therm0/trips/pa-therm0-trip1";
		pa_therm0_trip2 = "/fragment@11/__overlay__/pa-therm0/trips/pa-therm0-trip2";
		fpc_reset_int = "/fragment@12/__overlay__/fpc_reset_int";
		fpc_reset_low = "/fragment@12/__overlay__/fpc_reset_int/reset_low";
		fpc_reset_high = "/fragment@12/__overlay__/fpc_reset_int/reset_high";
		fpc_int_low = "/fragment@12/__overlay__/fpc_reset_int/int_low";
		pm7250b_charger = "/fragment@14/__overlay__/qcom,pm7250b@2/qcom,qpnp-smb5";
		smb5_vbus = "/fragment@14/__overlay__/qcom,pm7250b@2/qcom,qpnp-smb5/qcom,smb5-vbus";
		smb5_vconn = "/fragment@14/__overlay__/qcom,pm7250b@2/qcom,qpnp-smb5/qcom,smb5-vconn";
		pm7250b_pdphy = "/fragment@14/__overlay__/qcom,pm7250b@2/qcom,usb-pdphy@1700";
		pm7250b_tz = "/fragment@14/__overlay__/qcom,pm7250b@2/qcom,temp-alarm@2400";
		pm7250b_qg = "/fragment@14/__overlay__/qcom,pm7250b@2/qpnp,qg";
		pm7250b_clkdiv = "/fragment@14/__overlay__/qcom,pm7250b@2/clock-controller@5b00";
		pm7250b_gpios = "/fragment@14/__overlay__/qcom,pm7250b@2/pinctrl@c000";
		disp_lcd_bias_en_default = "/fragment@14/__overlay__/qcom,pm7250b@2/pinctrl@c000/disp_lcd_bias_en/disp_lcd_bias_en_default";
		pm7250b_vadc = "/fragment@14/__overlay__/qcom,pm7250b@2/vadc@3100";
		pm7250b_adc_tm = "/fragment@14/__overlay__/qcom,pm7250b@2/adc_tm@3500";
		pm7250b_bcl = "/fragment@14/__overlay__/qcom,pm7250b@2/bcl@1d00";
		bcl_soc = "/fragment@14/__overlay__/qcom,pm7250b@2/bcl-soc";
		pm7250b_vib = "/fragment@14/__overlay__/qcom,pm7250b@3/qcom,vibrator@5300";
		pm7250b_temp_alarm = "/fragment@15/__overlay__/pm7250b-tz";
		pm7250b_trip0 = "/fragment@15/__overlay__/pm7250b-tz/trips/trip0";
		pm7250b_trip1 = "/fragment@15/__overlay__/pm7250b-tz/trips/trip1";
		ibat_lvl0 = "/fragment@15/__overlay__/pm7250b-ibat-lvl0/trips/ibat-lvl0";
		ibat_lvl1 = "/fragment@15/__overlay__/pm7250b-ibat-lvl1/trips/ibat-lvl1";
		b_bcl_lvl0 = "/fragment@15/__overlay__/pm7250b-bcl-lvl0/trips/b-bcl-lvl0";
		b_bcl_lvl1 = "/fragment@15/__overlay__/pm7250b-bcl-lvl1/trips/b-bcl-lvl1";
		b_bcl_lvl2 = "/fragment@15/__overlay__/pm7250b-bcl-lvl2/trips/b-bcl-lvl2";
		soc_trip = "/fragment@15/__overlay__/socd/trips/soc-trip";
		qrd_batterydata = "/fragment@18/__overlay__/qcom,battery-data";
		smb_int_default = "/fragment@19/__overlay__/smb_int_default";
		smb1394 = "/fragment@20/__overlay__/qcom,smb1394@34";
		smb1394_div2_cp_primary = "/fragment@20/__overlay__/qcom,smb1394@34/qcom,div2_cp_pry";
	};

	__fixups__ {
		thermal_zones = "/fragment@0:target:0", "/fragment@11:target:0", "/fragment@15:target:0", "/fragment@16:target:0", "/fragment@17:target:0", "/fragment@22:target:0";
		pm6125_trip0 = "/fragment@0/__overlay__/pm6125-tz/cooling-maps/trip0_cpu0:trip:0", "/fragment@0/__overlay__/pm6125-tz/cooling-maps/trip0_cpu4:trip:0";
		CPU0 = "/fragment@0/__overlay__/pm6125-tz/cooling-maps/trip0_cpu0:cooling-device:0", "/fragment@11/__overlay__/quiet-therm/cooling-maps/silver_cdev:cooling-device:0";
		CPU4 = "/fragment@0/__overlay__/pm6125-tz/cooling-maps/trip0_cpu4:cooling-device:0", "/fragment@11/__overlay__/quiet-therm/cooling-maps/gold_cdev:cooling-device:0", "/fragment@17/__overlay__/pm7250b-bcl-lvl0/cooling-maps/lbat0_cpufreq4:cooling-device:0";
		pm6125_trip1 = "/fragment@0/__overlay__/pm6125-tz/cooling-maps/trip1_cpu1:trip:0", "/fragment@0/__overlay__/pm6125-tz/cooling-maps/trip1_cpu2:trip:0", "/fragment@0/__overlay__/pm6125-tz/cooling-maps/trip1_cpu3:trip:0", "/fragment@0/__overlay__/pm6125-tz/cooling-maps/trip1_cpu4:trip:0", "/fragment@0/__overlay__/pm6125-tz/cooling-maps/trip1_cpu5:trip:0", "/fragment@0/__overlay__/pm6125-tz/cooling-maps/trip1_cpu6:trip:0", "/fragment@0/__overlay__/pm6125-tz/cooling-maps/trip1_cpu7:trip:0";
		cpu1_pause = "/fragment@0/__overlay__/pm6125-tz/cooling-maps/trip1_cpu1:cooling-device:0";
		cpu2_pause = "/fragment@0/__overlay__/pm6125-tz/cooling-maps/trip1_cpu2:cooling-device:0";
		cpu3_pause = "/fragment@0/__overlay__/pm6125-tz/cooling-maps/trip1_cpu3:cooling-device:0";
		cpu4_pause = "/fragment@0/__overlay__/pm6125-tz/cooling-maps/trip1_cpu4:cooling-device:0", "/fragment@17/__overlay__/socd/cooling-maps/soc_cpu4:cooling-device:0", "/fragment@17/__overlay__/pm7250b-bcl-lvl1/cooling-maps/lbat1_cpu4:cooling-device:0";
		cpu5_pause = "/fragment@0/__overlay__/pm6125-tz/cooling-maps/trip1_cpu5:cooling-device:0", "/fragment@17/__overlay__/socd/cooling-maps/soc_cpu5:cooling-device:0", "/fragment@17/__overlay__/pm7250b-bcl-lvl1/cooling-maps/lbat1_cpu5:cooling-device:0";
		cpu6_pause = "/fragment@0/__overlay__/pm6125-tz/cooling-maps/trip1_cpu6:cooling-device:0", "/fragment@17/__overlay__/socd/cooling-maps/soc_cpu6:cooling-device:0", "/fragment@17/__overlay__/pm7250b-bcl-lvl0/cooling-maps/lbat0_cpu6:cooling-device:0";
		cpu7_pause = "/fragment@0/__overlay__/pm6125-tz/cooling-maps/trip1_cpu7:cooling-device:0", "/fragment@17/__overlay__/socd/cooling-maps/soc_cpu7:cooling-device:0", "/fragment@17/__overlay__/pm7250b-bcl-lvl0/cooling-maps/lbat0_cpu7:cooling-device:0";
		pm6125_gpios = "/fragment@1:target:0", "/fragment@2/__overlay__/gpio_keys/vol_up:gpios:0", "/fragment@2/__overlay__/vdda_usb_ss_dp_core:gpio:0";
		soc = "/fragment@2:target:0", "/fragment@13:target:0", "/fragment@18:target:0";
		usb_qmp_dp_phy = "/fragment@3:target:0";
		qupv3_se1_i2c = "/fragment@4:target:0", "/fragment@20:target:0";
		sdhc_1 = "/fragment@5:target:0";
		L24A = "/fragment@5/__overlay__:vdd-supply:0", "/fragment@8/__overlay__:vcc-supply:0";
		L11A = "/fragment@5/__overlay__:vdd-io-supply:0", "/fragment@8/__overlay__:vccq2-supply:0";
		sdc1_on = "/fragment@5/__overlay__:pinctrl-0:0";
		sdc1_off = "/fragment@5/__overlay__:pinctrl-1:0";
		sdhc_2 = "/fragment@6:target:0";
		L22A = "/fragment@6/__overlay__:vdd-supply:0";
		L5A = "/fragment@6/__overlay__:vdd-io-supply:0";
		L7A = "/fragment@6/__overlay__:vdd-io-bias-supply:0";
		sdc2_on = "/fragment@6/__overlay__:pinctrl-0:0";
		sdc2_off = "/fragment@6/__overlay__:pinctrl-1:0";
		tlmm = "/fragment@6/__overlay__:cd-gpios:0", "/fragment@8/__overlay__:reset-gpios:0", "/fragment@10/__overlay__/synaptics_tcm@20:interrupt-parent:0", "/fragment@10/__overlay__/synaptics_tcm@20:synaptics,irq-gpio:0", "/fragment@10/__overlay__/synaptics_tcm@20:synaptics,reset-gpio:0", "/fragment@12:target:0", "/fragment@19:target:0", "/fragment@20/__overlay__/qcom,smb1394@34:interrupt-parent:0";
		ufsphy_mem = "/fragment@7:target:0";
		L4A = "/fragment@7/__overlay__:vdda-phy-supply:0";
		L18A = "/fragment@7/__overlay__:vdda-pll-supply:0", "/fragment@8/__overlay__:qcom,vddp-ref-clk-supply:0";
		ufshc_mem = "/fragment@8:target:0";
		gcc_ufs_phy_gdsc = "/fragment@8/__overlay__:vdd-hba-supply:0";
		gcc = "/fragment@8/__overlay__:resets:0";
		pm6125_pwm = "/fragment@9:target:0";
		qupv3_se2_i2c = "/fragment@10:target:0";
		ts_int_active = "/fragment@10/__overlay__/synaptics_tcm@20:pinctrl-0:0";
		ts_reset_active = "/fragment@10/__overlay__/synaptics_tcm@20:pinctrl-0:4";
		ts_int_suspend = "/fragment@10/__overlay__/synaptics_tcm@20:pinctrl-1:0";
		ts_reset_suspend = "/fragment@10/__overlay__/synaptics_tcm@20:pinctrl-1:4";
		ts_release = "/fragment@10/__overlay__/synaptics_tcm@20:pinctrl-2:0";
		msm_gpu = "/fragment@11/__overlay__/quiet-therm/cooling-maps/gpu_cdev:cooling-device:0", "/fragment@17/__overlay__/pm7250b-bcl-lvl0/cooling-maps/lbat0_gpu:cooling-device:0", "/fragment@17/__overlay__/pm7250b-bcl-lvl1/cooling-maps/lbat1_gpu:cooling-device:0", "/fragment@17/__overlay__/pm7250b-bcl-lvl2/cooling-maps/lbat2_gpu:cooling-device:0";
		cdsp_sw = "/fragment@11/__overlay__/quiet-therm/cooling-maps/hvx_cdev:cooling-device:0", "/fragment@17/__overlay__/pm7250b-bcl-lvl0/cooling-maps/lbat0_cdsp:cooling-device:0", "/fragment@17/__overlay__/pm7250b-bcl-lvl1/cooling-maps/lbat1_cdsp:cooling-device:0", "/fragment@17/__overlay__/pm7250b-bcl-lvl2/cooling-maps/lbat2_cdsp:cooling-device:0";
		modem_proc = "/fragment@11/__overlay__/quiet-therm/cooling-maps/mdm_cdev0:cooling-device:0", "/fragment@11/__overlay__/quiet-therm/cooling-maps/mdm_cdev1:cooling-device:0";
		modem_pa = "/fragment@11/__overlay__/pa-therm0/cooling-maps/modem_cdev0:cooling-device:0", "/fragment@11/__overlay__/pa-therm0/cooling-maps/modem_cdev1:cooling-device:0", "/fragment@11/__overlay__/pa-therm0/cooling-maps/modem_cdev2:cooling-device:0";
		spmi_bus = "/fragment@14:target:0";
		usb2_phy0 = "/fragment@14/__overlay__/qcom,pm7250b@2/qcom,qpnp-smb5:dpdm-supply:0";
		L15A = "/fragment@14/__overlay__/qcom,pm7250b@2/qcom,usb-pdphy@1700:vdd-pdphy-supply:0";
		pm6125_rtc = "/fragment@14/__overlay__/qcom,pm7250b@2/qpnp,qg:depends-on-supply:0";
		rpmcc = "/fragment@14/__overlay__/qcom,pm7250b@2/clock-controller@5b00:clocks:0";
		usb0 = "/fragment@21:target:0";
		eud = "/fragment@21/__overlay__:extcon:8";
	};

	__local_fixups__ {

		fragment@2 {

			__overlay__ {

				gpio_keys {
					pinctrl-0 = <0x0>;
				};

				vdda_usb_ss_dp_core {
					pinctrl-0 = <0x0>;
				};
			};
		};

		fragment@3 {

			__overlay__ {
				vdd-supply = <0x0>;
			};
		};

		fragment@11 {

			__overlay__ {

				quiet-therm {

					cooling-maps {

						gold_cdev {
							trip = <0x0>;
						};

						silver_cdev {
							trip = <0x0>;
						};

						gpu_cdev {
							trip = <0x0>;
						};

						hvx_cdev {
							trip = <0x0>;
						};

						mdm_cdev0 {
							trip = <0x0>;
						};

						mdm_cdev1 {
							trip = <0x0>;
						};
					};
				};

				pa-therm0 {

					cooling-maps {

						modem_cdev0 {
							trip = <0x0>;
						};

						modem_cdev1 {
							trip = <0x0>;
						};

						modem_cdev2 {
							trip = <0x0>;
						};
					};
				};
			};
		};

		fragment@14 {

			__overlay__ {

				qcom,pm7250b@2 {

					qcom,qpnp-smb5 {
						depends-on-supply = <0x0>;
						io-channels = <0x0 0x8 0x10 0x18 0x20 0x28 0x30 0x38 0x40 0x48 0x50 0x58 0x60 0x68 0x70 0x78 0x80 0x88 0x90 0x98 0xa0 0xa8 0xb0 0xb8>;
						qcom,battery-data = <0x0>;
					};

					qcom,usb-pdphy@1700 {
						vbus-supply = <0x0>;
						vconn-supply = <0x0>;
						io-channels = <0x0 0x8 0x10 0x18 0x20 0x28 0x30 0x38 0x40 0x48 0x50 0x58 0x60 0x68>;
					};

					qcom,temp-alarm@2400 {
						io-channels = <0x0>;
					};

					qpnp,qg {
						io-channels = <0x0 0x8 0x10 0x18 0x20 0x28>;
					};

					clock-controller@5b00 {
						assigned-clocks = <0x0>;
					};

					adc_tm@3500 {

						charger_skin_therm@4d {
							io-channels = <0x0>;
						};

						conn_therm@4f {
							io-channels = <0x0>;
						};
					};
				};
			};
		};

		fragment@15 {

			__overlay__ {

				pm7250b-tz {
					thermal-sensors = <0x0>;
				};

				pm7250b-ibat-lvl0 {
					thermal-sensors = <0x0>;
				};

				pm7250b-ibat-lvl1 {
					thermal-sensors = <0x0>;
				};

				pm7250b-bcl-lvl0 {
					thermal-sensors = <0x0>;
				};

				pm7250b-bcl-lvl1 {
					thermal-sensors = <0x0>;
				};

				pm7250b-bcl-lvl2 {
					thermal-sensors = <0x0>;
				};
			};
		};

		fragment@16 {

			__overlay__ {

				charger-therm-usr {
					thermal-sensors = <0x0>;
				};

				conn-therm-usr {
					thermal-sensors = <0x0>;
				};
			};
		};

		fragment@17 {

			__overlay__ {

				pm7250b-tz {

					cooling-maps {

						trip0_bat {
							trip = <0x0>;
							cooling-device = <0x0>;
						};

						trip1_bat {
							trip = <0x0>;
							cooling-device = <0x0>;
						};
					};
				};

				socd {

					cooling-maps {

						soc_cpu4 {
							trip = <0x0>;
						};

						soc_cpu5 {
							trip = <0x0>;
						};

						soc_cpu6 {
							trip = <0x0>;
						};

						soc_cpu7 {
							trip = <0x0>;
						};
					};
				};

				pm7250b-bcl-lvl0 {

					cooling-maps {

						lbat0_cpufreq4 {
							trip = <0x0>;
						};

						lbat0_cpu6 {
							trip = <0x0>;
						};

						lbat0_cpu7 {
							trip = <0x0>;
						};

						lbat0_gpu {
							trip = <0x0>;
						};

						lbat0_cdsp {
							trip = <0x0>;
						};
					};
				};

				pm7250b-bcl-lvl1 {

					cooling-maps {

						lbat1_cpu4 {
							trip = <0x0>;
						};

						lbat1_cpu5 {
							trip = <0x0>;
						};

						lbat1_gpu {
							trip = <0x0>;
						};

						lbat1_cdsp {
							trip = <0x0>;
						};
					};
				};

				pm7250b-bcl-lvl2 {

					cooling-maps {

						lbat2_gpu {
							trip = <0x0>;
						};

						lbat2_cdsp {
							trip = <0x0>;
						};
					};
				};
			};
		};

		fragment@20 {

			__overlay__ {

				qcom,smb1394@34 {
					pinctrl-0 = <0x0>;

					qcom,div2_cp_pry {
						io-channels = <0x0>;
					};
				};
			};
		};

		fragment@21 {

			__overlay__ {
				extcon = <0x0 0x4>;
			};
		};

		fragment@22 {

			__overlay__ {

				quiet-therm {

					cooling-maps {

						quiet_batt_cdev1 {
							trip = <0x0>;
							cooling-device = <0x0>;
						};

						quiet_batt_cdev2 {
							trip = <0x0>;
							cooling-device = <0x0>;
						};

						quiet_batt_cdev3 {
							trip = <0x0>;
							cooling-device = <0x0>;
						};

						quiet_batt_cdev4 {
							trip = <0x0>;
							cooling-device = <0x0>;
						};
					};
				};

				pm7250b-tz {

					cooling-maps {

						trip0_bat {
							cooling-device = <0x0>;
						};

						trip1_bat {
							cooling-device = <0x0>;
						};
					};
				};
			};
		};
	};
};
